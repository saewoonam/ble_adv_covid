## prj.conf
```kconfig
CONFIG_STDOUT_CONSOLE=y
# CONFIG_GPIO=y
# CONFIG_USB=y
# CONFIG_USB_DEVICE_STACK=y
# CONFIG_USB_DEVICE_PRODUCT="CO19 BT Dongle v0.1"
# CONFIG_LOG=y
# CONFIG_USB_DRIVER_LOG_LEVEL_ERR=y
# CONFIG_USB_CDC_ACM=y
# CONFIG_USB_DEVICE_LOG_LEVEL_ERR=y
# CONFIG_SERIAL=y

# CONFIG_UART_INTERRUPT_DRIVEN=y
# CONFIG_UART_LINE_CTRL=y
# CONFIG_USB_UART_DTR_WAIT=n

# 
CONFIG_BT=y
CONFIG_BT_DEBUG_LOG=y
CONFIG_BT_BROADCASTER=y
CONFIG_BT_OBSERVER=y

# 
CONFIG_PRINTK=y
CONFIG_HEAP_MEM_POOL_SIZE=256
# CONFIG_ASSERT=y

# fs_dirent structures are big.
# CONFIG_MAIN_STACK_SIZE=2048
# littlefs
# CONFIG_FLASH=y
# CONFIG_FLASH_MAP=y
# CONFIG_FLASH_PAGE_LAYOUT=y

# CONFIG_FILE_SYSTEM=y
# CONFIG_FILE_SYSTEM_LITTLEFS=y

#CONFIG_UART_CONSOLE_INIT_PRIORITY=91
#CONFIG_USE_SEGGER_RTT=y
#CONFIG_RTT_CONSOLE=y
#CONFIG_SEGGER_SYSTEMVIEW=y
CONFIG_STDOUT_CONSOLE=y
CONFIG_LOG=y
CONFIG_I2C=y
CONFIG_SENSOR=y
CONFIG_LIS2DH=y

CONFIG_DISPLAY=y
CONFIG_MICROBIT_DISPLAY=y
```

## src/main.c
```c
/* main.c - Application main entry point */

/*
 * Copyright (c) 2015-2016 Intel Corporation
 *
 * SPDX-License-Identifier: Apache-2.0
 */

#include <zephyr/types.h>
#include <stddef.h>
#include <sys/util.h>

#include <bluetooth/bluetooth.h>
#include <bluetooth/hci.h>

#include <sys/printk.h>
#include <sys/util.h>
#include <stdio.h>

#include <drivers/sensor.h>

#include <zephyr.h>
#include <drivers/gpio.h>
#include <device.h>
#include <display/mb_display.h>

#define RPI_PERIOD 50  // mSec

#define BT_LE_ADV_NCONN2 BT_LE_ADV_PARAM(4, BT_GAP_ADV_FAST_INT_MIN_2, \
                                        BT_GAP_ADV_FAST_INT_MAX_2, NULL)


extern void rpi_init(u8_t *rpi);
extern void rpi_update(u8_t *rpi);

struct device *i2c_dev;
/*
struct bt_le_scan_param scan_param = {
    .type       = BT_HCI_LE_SCAN_PASSIVE,
    .options    = BT_LE_SCAN_OPT_NONE,
    .interval   = 0x0010,
    .window     = 0x0010,
};
*/

void main(void)
{
    int err;
    /*
    led_init(&led1);
    led_init(&led2);
    led_init(&led3);
    led_init(&led4);
    for (int i=0; i<5; i++){
        flash(&led1);
        flash(&led2);
        flash(&led3);
        flash(&led4);
    }
    */
    int x=0;
    int y=0;

    struct mb_display *disp = mb_display_get();
                        struct mb_image pixel = {};
                        pixel.row[y] = BIT(x);
                        mb_display_image(disp, MB_DISPLAY_MODE_SINGLE,
                                         K_MSEC(1000), &pixel, 1);

    i2c_dev = device_get_binding(DT_ALIAS_I2C_0_LABEL);
    // i2c_dev = device_get_binding("LSM303AGR-ACCEL");
    // *mag_dev = device_get_binding("LSM303AGR-MAGN");

    if (i2c_dev == NULL) {
            printf("Could not get i2c device\n");
            return;
    }
    bt_set_name("COVID 19");
    printk("%s\n", bt_get_name());
    err = bt_enable(NULL);
    if (err) {
        printk("Bluetooth init failed (err %d)\n", err);
        return;
    }
    printk("Bluetooth initialized\n");

    u8_t *tcn;
    struct bt_data encounter_ad[] = {
            BT_DATA_BYTES(BT_DATA_FLAGS, BT_LE_AD_NO_BREDR),
           // BT_DATA_BYTES(BT_DATA_TX_POWER, 0),
            BT_DATA_BYTES(BT_DATA_UUID16_ALL, 0x6F, 0xFD),
            BT_DATA_BYTES(BT_DATA_SVC_DATA16,
                            0x6F, 0xFD,
                            0,0,0,0,0,0,0,0,
                            0,0,0,0,0,0,0,0,
                            0x04, 0x3, 0x2, 0x1)
    };

    tcn = encounter_ad[2].data+2; // 3rd item in array of messages is RPI
    rpi_init(tcn);
    // u32_t round=0;
    k_sleep(K_MSEC(400));

    /* Start advertising */
    /*
     *
     *  We will move start into the loop to change the address repeatably
     *  For now, outside the loop so that it is easier to debug and use in BT
     *  tests
     *
     */
    rpi_update(tcn);
    err = bt_le_adv_start(BT_LE_ADV_NCONN2, encounter_ad,
                            ARRAY_SIZE(encounter_ad), NULL, 0);
    if (err) {
        printk("Advertising failed to start (err %d)\n", err);
        return;
    }
    int flash_counter = 0;
    pixel.row[y] = BIT(0);
    do {
        if (flash_counter==0) {
            mb_display_image(disp, MB_DISPLAY_MODE_SINGLE,
                    K_MSEC(RPI_PERIOD), &pixel, 1);
        } else {
            k_sleep(K_MSEC(RPI_PERIOD));
        }
        flash_counter++;
        flash_counter = flash_counter % 10;

        rpi_update(tcn);
        err = bt_le_adv_update_data(encounter_ad, ARRAY_SIZE(encounter_ad), NULL, 0);
        if (err) {
            printk("Advertising failed to stop (err %d)\n", err);
            return;
        }
        printk("Update rpi\n");
    } while (1);

}
```

## src/rpi.c
```c
#include <stdio.h>
#include <string.h>
#include <device.h>
//#include <drivers/uart.h>
#include <zephyr.h>
//#include <sys/ring_buffer.h>

#include <sys/util.h>
#include <drivers/i2c.h>

#define CFG_REG_A_M 0x60
#define CFG_REG_C_M 0x62
#define STATUS_REG_M 0x67
#define OUTX_L_REG_M 0x68
#define STATUS_REG_A 0x27
#define CTRL_REG1_A 0x20
#define OUT_X_L_A 0x28

int8_t mag[6];
int8_t acc[6];

extern struct device *i2c_dev;

static int fetch_mag(struct device *sensor, int8_t *out){
        int rc = 0;
        uint8_t status=0;
        // float x, y, z;
        uint8_t address = 0x1e;  // i2c address

        rc = i2c_reg_read_byte(sensor, address, STATUS_REG_M, &status);
        rc = i2c_burst_read(sensor, address, OUTX_L_REG_M, out, 6);
        /*
        x = out[0] + (out[1]<<8);
        y = out[2] + (out[3]<<8);
        z = out[4] + (out[5]<<8);
        printk("mag: %f, %f, %f\n", x, y, z);
        */
        return rc;
}
static int fetch_acc(struct device *sensor, int8_t *out) {
        int rc = 0;
        // float x, y, z;
        uint16_t address = 0x19;

        rc = i2c_reg_read_byte(sensor, 0x19, OUT_X_L_A, out);
        rc += i2c_reg_read_byte(sensor, 0x19, OUT_X_L_A+1, out+1);
        // x = out[0] + (out[1]<<8);
        rc += i2c_reg_read_byte(sensor, 0x19, OUT_X_L_A+2, out+2);
        rc += i2c_reg_read_byte(sensor, 0x19, OUT_X_L_A+3, out+3);
        // y = out[2] + (out[3]<<8);
        rc += i2c_reg_read_byte(sensor, 0x19, OUT_X_L_A+4, out+4);
        rc += i2c_reg_read_byte(sensor, 0x19, OUT_X_L_A+5, out+5);
        // z = out[4] + (out[5]<<8);
        // printk("acc: %f, %f, %f\n", x, y, z);
        return rc;
}


void rpi_init(u8_t *rpi) {
    /*
    rpi = encounter_ad[3].data+2; // 4th item in array of messages is RPI
    rpi[15] = 0xC0;
    rpi[14] = 0x19;
    rpi[13] = 0;
    rpi[12] = 0;
    */
    // rpi = encounter_ad[2].data+2; // 3rd item in array of messages is RPI
    rpi[19] = 0xC0;
    rpi[18] = 0x19;
    rpi[17] = 0;
    rpi[16] = 0;

    int rc = 0;
    rc = i2c_reg_write_byte(i2c_dev,0x1e, CFG_REG_A_M, 0x00) ;
    rc += i2c_reg_write_byte(i2c_dev,0x1e, CFG_REG_C_M, 0x01) ;
    rc += i2c_reg_write_byte(i2c_dev,0x19, CTRL_REG1_A, 0x57);

}

void rpi_update(u8_t *rpi) {
    static u16_t round = 0;
    // Original google/apple spec
    // memcpy(rpi, &round, 4);  // try to copy round to lowest 4 bytes of rpi
    // New google/apple spec
    round++;
    rpi[0] = 0x00;
    rpi[1] = 0x00;
    rpi[2] = 0x00;
    rpi[3] = 0x40;
    memcpy(rpi+4, &round, 2);  // try to copy round to lowest 4 bytes of rpi
    fetch_acc(i2c_dev, acc);
    memcpy(rpi+6, acc, 6);
    fetch_mag(i2c_dev, mag);
    memcpy(rpi+12, acc, 6);
}
```
