## CMakeLists.txt
```
# SPDX-License-Identifier: Apache-2.0

cmake_minimum_required(VERSION 3.13.1)
find_package(Zephyr HINTS $ENV{ZEPHYR_BASE})
project(ubit_all_nofs)

FILE(GLOB app_sources src/*.c)
target_sources(app PRIVATE ${app_sources})

zephyr_library_include_directories(${ZEPHYR_BASE}/samples/bluetooth)
```

## prj.conf
```kconfig
CONFIG_GPIO=y
CONFIG_CONSOLE=n
CONFIG_STDOUT_CONSOLE=n
CONFIG_UART_CONSOLE=n
CONFIG_SERIAL=y
CONFIG_UART_INTERRUPT_DRIVEN=y

CONFIG_BT=y
CONFIG_BT_DEBUG_LOG=y
CONFIG_BT_BROADCASTER=y
CONFIG_BT_OBSERVER=y

# 
CONFIG_PRINTK=y
CONFIG_HEAP_MEM_POOL_SIZE=256
# CONFIG_ASSERT=y

CONFIG_I2C=y
# CONFIG_SENSOR=y
# CONFIG_LIS2DH=y

CONFIG_DISPLAY=y
CONFIG_MICROBIT_DISPLAY=y

# fs_dirent structures are big.
# CONFIG_MAIN_STACK_SIZE=2048
# littlefs
# CONFIG_FLASH=y
# CONFIG_FLASH_MAP=y
# CONFIG_FLASH_PAGE_LAYOUT=y

# CONFIG_FILE_SYSTEM=y
# CONFIG_FILE_SYSTEM_LITTLEFS=y

#CONFIG_UART_CONSOLE_INIT_PRIORITY=91
#CONFIG_USE_SEGGER_RTT=y
#CONFIG_RTT_CONSOLE=y
#CONFIG_SEGGER_SYSTEMVIEW=y
```

## src/main.c
```c
/* main.c - Application main entry point */

/*
 * Copyright (c) 2020 Sae Woo Nam
 *
 * SPDX-License-Identifier: Apache-2.0
 */

#include <zephyr/types.h>
#include <stddef.h>
// #include <sys/printk.h>
#include <sys/util.h>

#include <bluetooth/bluetooth.h>
#include <bluetooth/hci.h>

#include <zephyr.h>
#include <device.h>
#include <drivers/uart.h>

#include <drivers/gpio.h>
#include <sys/util.h>
#include <inttypes.h>

#include <display/mb_display.h>

bool bt_started=false;
bool start_adv=false;
bool cdc_open=false;
bool write_flash=false;
bool show_raw=false;
struct device *uart_dev;
struct device *i2c_dev;
struct mb_display *disp;

extern void bt_init(void);
extern void start_scan(void);
extern void bt_adv(void);

struct bt_le_scan_param scan_param = {
    .type       = BT_HCI_LE_SCAN_PASSIVE,
    .options    = BT_LE_SCAN_OPT_NONE,
    .interval   = 0x0010,
    .window     = 0x0010,
};

uint8_t saewoo_hack[2] = {0xDE, 0xAD};
struct device *button_dev;
extern void uart_print(struct device *dev, char *buffer);

void button_pressed(struct device *dev, struct gpio_callback *cb,
            u32_t pins)
{
    struct mb_image pixel = {};
    pixel.row[4] = BIT(0);

    uart_print(uart_dev, "button\n");
    start_adv = !start_adv;
    mb_display_image(disp, MB_DISPLAY_MODE_SINGLE,
            K_MSEC(50), &pixel, 1);
    
}

void button_init(void){
    int ret;
    static struct gpio_callback button_cb_data;

    button_dev = device_get_binding(DT_ALIAS_SW0_GPIOS_CONTROLLER);
    if (button_dev == NULL) {
        return;
    }

    ret = gpio_pin_configure(button_dev, DT_ALIAS_SW0_GPIOS_PIN,
                 DT_ALIAS_SW0_GPIOS_FLAGS | GPIO_INPUT);
    if (ret != 0) {
        return;
    }

    ret = gpio_pin_interrupt_configure(button_dev, DT_ALIAS_SW0_GPIOS_PIN,
                       GPIO_INT_EDGE_TO_ACTIVE);
    if (ret != 0) {
        return;
    }

    gpio_init_callback(&button_cb_data, button_pressed,
               BIT(DT_ALIAS_SW0_GPIOS_PIN));
    gpio_add_callback(button_dev, &button_cb_data);

}


void main(void)
{
    // int err;
    /*
    led_init(&led1);
    led_init(&led2);
    led_init(&led3);
    led_init(&led4);
    for (int i=0; i<5; i++){
        flash(&led1);
        flash(&led2);
        flash(&led3);
        flash(&led4);
    }
    */
    struct uart_config cfg;
    int rc;

    int x=0;
    int y=0;
    disp = mb_display_get();
    struct mb_image pixel = {};
    pixel.row[y] = BIT(x);
    mb_display_image(disp, MB_DISPLAY_MODE_SINGLE,
                     K_MSEC(1000), &pixel, 1);

    i2c_dev = device_get_binding(DT_ALIAS_I2C_0_LABEL);
    // i2c_dev = device_get_binding("LSM303AGR-ACCEL");
    // *mag_dev = device_get_binding("LSM303AGR-MAGN");

    if (i2c_dev == NULL) {
            // printf("Could not get i2c device\n");
            return;
    }
    // Setup output to usb-serial port on computer
    uart_dev = device_get_binding("UART_0");
    // Change baud rate to 9600 per DAP_link notes
    // https://tech.microbit.org/software/daplink-interface/
    rc = uart_config_get(uart_dev, &cfg);
    cfg.baudrate = 9600;
    rc = uart_configure(uart_dev, &cfg);
    button_init();
    // Start BT
    bt_init();
    start_adv = true;
    // printk("Bluetooth initialized\n");
    start_scan();
    bt_adv();
}
```

## src/bt.c
```c
//  SPDX-License-Identifier: Apache-2.0
#include <zephyr/types.h>
#include <stddef.h>
#include <sys/printk.h>
#include <sys/util.h>

#include <bluetooth/bluetooth.h>
#include <bluetooth/hci.h>
#include <stdio.h>

#include <drivers/uart.h>

#include <display/mb_display.h>

#define RPI_PERIOD 200  // mSec

extern void rpi_init(u8_t *rpi);
extern void rpi_update(u8_t *rpi);

extern bool bt_started;
extern bool start_adv;
extern bool cdc_open;
extern bool write_flash;
extern bool show_raw;
extern struct bt_le_scan_param scan_param ;
extern struct device *uart_dev;
extern struct mb_display *disp;

extern uint8_t saewoo_hack[2];

/*
  #define BT_LE_ADV_NCONN2 BT_LE_ADV_PARAM(4, BT_GAP_ADV_FAST_INT_MIN_2, \
                                        BT_GAP_ADV_FAST_INT_MAX_2, NULL)
                                        */
#define BT_LE_ADV_NCONN2 BT_LE_ADV_PARAM(4, 100, \
                                        300, NULL)

void uart_write(struct device *dev, uint8_t *buffer, uint8_t length) {
    for(int i=0; i<length; i++) {
            uart_poll_out(dev, buffer[i]);
    }
}

void uart_print(struct device *dev, char *buffer) {
        uart_write(dev, buffer, strlen(buffer));
}

void bt_init(void) {
    int err;
    printk("Starting Scanner/Advertiser Demo\n");

    /* Initialize the Bluetooth Subsystem */
    err = bt_enable(NULL);
    if (err) {
        printk("Bluetooth init failed (err %d)\n", err);
        return;
    }
    bt_started = true;
    printk("Bluetooth initialized\n");
}


void bt_adv (void) {
    u8_t *tcn;
    struct bt_data encounter_ad[] = {
            BT_DATA_BYTES(BT_DATA_FLAGS, BT_LE_AD_NO_BREDR),
            // BT_DATA_BYTES(BT_DATA_TX_POWER, 0),
            BT_DATA_BYTES(BT_DATA_UUID16_ALL, 0x6F, 0xFD),
            BT_DATA_BYTES(BT_DATA_SVC_DATA16,
                            0x6F, 0xFD,
                            0,0,0,0,0,0,0,0,
                            0,0,0,0,0,0,0,0,
                            0x04, 0x3, 0x2, 0x1)
    };
    /*
    while (!start_adv) {
        printk("BT not started\n");
        k_sleep(K_MSEC(1000));
    } 
    printk("Trying to start advertising\n");
    */
    tcn = encounter_ad[2].data+2; // 3rd item in array of messages is RPI
    rpi_init(tcn);
    // u32_t round=0;
    k_sleep(K_MSEC(400));

    /* Start advertising */
    /*
     *
     *  We will move start into the loop to change the address repeatably
     *  For now, outside the loop so that it is easier to debug and use in BT
     *  tests
     *
     */
    rpi_update(tcn);
    int err = bt_le_adv_start(BT_LE_ADV_NCONN2, encounter_ad,
                            ARRAY_SIZE(encounter_ad), NULL, 0);
    if (err) {
        printk("Advertising failed to start (err %d)\n", err);
        return;
    }
    u32_t now, old;
    old = k_uptime_get_32();
    char c;
    int rc=0;
    int flash_counter = 0;
    struct mb_image pixel = {};
    pixel.row[0] = BIT(0);
    do {
        while (!start_adv) {
            printk("BT not started\n");
            k_sleep(K_MSEC(1000));
        }

        now = k_uptime_get_32();
        // blink(&led1,1);
        // k_sleep(K_MSEC(RPI_PERIOD));
        
        if ((now-old) > RPI_PERIOD) { 
            rpi_update(tcn);
            err = bt_le_adv_update_data(encounter_ad, ARRAY_SIZE(encounter_ad), NULL, 0);
            /*  Will not use update... but stop in version that randomized MAC */
            /*
            // err = bt_le_adv_stop();
            if (err) {
                printk("Advertising failed to stop (err %d)\n", err);
                return;
            }
            */
            old = now;
            if (flash_counter==0) {
                mb_display_image(disp, MB_DISPLAY_MODE_SINGLE,
                        K_MSEC(20), &pixel, 1);
            } else {
                k_sleep(K_MSEC(RPI_PERIOD));
            }
            flash_counter++;
            flash_counter = flash_counter % 10;
/*
            // move these two lines oustide the loop in case there are garbage
            // collection issues
            char rpi_string[64];
            int len = 0;
            //
            //
            len = sprintf(rpi_string, "Update rpi: ");
            for (int i=0; i<20; i++) {
                len += sprintf(rpi_string+len, "%02X", tcn[i]);
            }
            len += sprintf(rpi_string+len, "\n");
            uart_print(uart_dev, rpi_string);
            */
        }
        rc = uart_poll_in(uart_dev, &c);
        if (rc==0) {
            switch (c)
            {
                case 'r':
                    show_raw = true;
                    break;
                case 'z':
                    show_raw = false;
                    break;
                default:
                    break;
            }
        }
    } while (1);
}


static bool data_cb_local(struct bt_data *data, void *user_data)
{
    u8_t *uuid16 = user_data;

    switch (data->type) {
    case BT_DATA_UUID16_ALL:
        memcpy(uuid16, data->data, 2);
        return false;
    default:
        return true;
    }
}

static void scan_cb_orig(const bt_addr_le_t *addr, s8_t rssi, u8_t adv_type,
            struct net_buf_simple *buf)
{
    // flash(&led2);
    u8_t uuid16[2] = {0, 0};
    u32_t timestamp = k_uptime_get_32();
    char rpi_string[64];

    int size = 0;
    for(u8_t i=0; i<buf->len; i++) {
        size += sprintf(rpi_string+size, "%02X", buf->data[i]);
    }
    bt_data_parse(buf, data_cb_local, uuid16);
    if ((uuid16[0]==0x6F) && (uuid16[1]==0xFD)) {
        // flash(&led3);
        char addr_string[20];
        size = 0;
        for(u8_t i=0; i<5; i++) {
            size += sprintf(addr_string+size, "%02X:", addr->a.val[5-i]);
        }
        size += sprintf(addr_string+size, "%02X", addr->a.val[0]);
        char line[128];
        sprintf(line, "%12d, %3d, %2d, %2d, %s, %s\n",
                timestamp, rssi, saewoo_hack[0]+37, saewoo_hack[1], addr_string, rpi_string);
        if (show_raw) {  // This puts it on the debugger
            size = strlen(line);
            uart_write(uart_dev, line, size);
            // printk("%s", line);
        }
    }
}


void start_scan(void) {
    //  Start Scan
    int err = bt_le_scan_start(&scan_param, scan_cb_orig);
    if (err) {
        printk("Starting scanning failed (err %d)\n", err);
        return;
    } else {
        printk("Scan started\n");
    }

}

void stop_scan(void) {
    int err = bt_le_scan_stop();
    if (err) {
        printk("Stop scanning failed (err %d)\n", err);
        return;
    } else {
        printk("Scan stopped\n");
    }
}
```

## src/rpi.c
```c
//  SPDX-License-Identifier: Apache-2.0
#include <stdio.h>
#include <string.h>
#include <device.h>
//#include <drivers/uart.h>
#include <zephyr.h>
//#include <sys/ring_buffer.h>

#include <sys/util.h>
#include <drivers/i2c.h>

#define CFG_REG_A_M 0x60
#define CFG_REG_C_M 0x62
#define STATUS_REG_M 0x67
#define OUTX_L_REG_M 0x68
#define STATUS_REG_A 0x27
#define CTRL_REG1_A 0x20
#define OUT_X_L_A 0x28

int8_t mag[6];
int8_t acc[6];

extern struct device *i2c_dev;

static int fetch_mag(struct device *sensor, int8_t *out){
        int rc = 0;
        uint8_t status=0;
        // float x, y, z;
        uint8_t address = 0x1e;  // i2c address
        int16_t *values = (int16_t *) out;
        int16_t temp;

        rc = i2c_reg_read_byte(sensor, address, STATUS_REG_M, &status);
        rc = i2c_burst_read(sensor, address, OUTX_L_REG_M, out, 6);
        //  Swap and negate x & y per 
        //  https://github.com/lancaster-university/microbit-dal/blob/master/source/drivers/LSM303Accelerometer.cpp
        temp = -values[0];
        values[0] = -values[1];
        values[1] = temp;
        /*
        x = out[0] + (out[1]<<8);
        y = out[2] + (out[3]<<8);
        z = out[4] + (out[5]<<8);
        printk("mag: %f, %f, %f\n", x, y, z);
        */
        return rc;
}
static int fetch_acc(struct device *sensor, int8_t *out) {
        int rc = 0;
        // float x, y, z;
        // uint16_t address = 0x19;
        int16_t *values = (int16_t *) out;
        int16_t temp=0;

        rc = i2c_reg_read_byte(sensor, 0x19, OUT_X_L_A, out);
        rc += i2c_reg_read_byte(sensor, 0x19, OUT_X_L_A+1, out+1);
        // x = out[0] + (out[1]<<8);
        rc += i2c_reg_read_byte(sensor, 0x19, OUT_X_L_A+2, out+2);
        rc += i2c_reg_read_byte(sensor, 0x19, OUT_X_L_A+3, out+3);
        // y = out[2] + (out[3]<<8);
        rc += i2c_reg_read_byte(sensor, 0x19, OUT_X_L_A+4, out+4);
        rc += i2c_reg_read_byte(sensor, 0x19, OUT_X_L_A+5, out+5);
        // z = out[4] + (out[5]<<8);
        // printk("acc: %f, %f, %f\n", x, y, z);

        //  Swap and negate x & y per 
        //  https://github.com/lancaster-university/microbit-dal/blob/master/source/drivers/LSM303Accelerometer.cpp
        temp = -values[0];
        values[0] = -values[1];
        values[1] = temp;
        return rc;
}


void rpi_init(u8_t *rpi) {
    /*
    rpi = encounter_ad[3].data+2; // 4th item in array of messages is RPI
    rpi[15] = 0xC0;
    rpi[14] = 0x19;
    rpi[13] = 0;
    rpi[12] = 0;
    */
    // rpi = encounter_ad[2].data+2; // 3rd item in array of messages is RPI
    rpi[19] = 0xC0;
    rpi[18] = 0x19;
    rpi[17] = 0;
    rpi[16] = 0;

    int rc = 0;
    rc = i2c_reg_write_byte(i2c_dev,0x1e, CFG_REG_A_M, 0x00) ;
    rc += i2c_reg_write_byte(i2c_dev,0x1e, CFG_REG_C_M, 0x01) ;
    rc += i2c_reg_write_byte(i2c_dev,0x19, CTRL_REG1_A, 0x57);

}

void rpi_update(u8_t *rpi) {
    static u16_t round = 0;
    // Original google/apple spec
    // memcpy(rpi, &round, 4);  // try to copy round to lowest 4 bytes of rpi
    // New google/apple spec
    round++;
    rpi[0] = 0x00;
    rpi[1] = 0x00;
    rpi[2] = 0x00;
    rpi[3] = 0x40;
    memcpy(rpi+4, &round, 2);  // try to copy round to lowest 4 bytes of rpi
    fetch_acc(i2c_dev, acc);
    memcpy(rpi+6, acc, 6);
    fetch_mag(i2c_dev, mag);
    memcpy(rpi+12, acc, 6);
}
```
