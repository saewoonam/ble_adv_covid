## CMakeLists.txt
```
# SPDX-License-Identifier: Apache-2.0

cmake_minimum_required(VERSION 3.13.1)
find_package(Zephyr HINTS $ENV{ZEPHYR_BASE})
project(bt_cdc_fs)

FILE(GLOB app_sources src/*.c)
target_sources(app PRIVATE ${app_sources})

# zephyr_library_include_directories(${ZEPHYR_BASE}/samples/bluetooth)
```

## prj.conf
```kconfig
CONFIG_STDOUT_CONSOLE=y
CONFIG_GPIO=y
CONFIG_USB=y
CONFIG_USB_DEVICE_STACK=y
CONFIG_USB_DEVICE_PRODUCT="CO19 BT Dongle v0.1"
CONFIG_USB_DEVICE_PID=0xC019
CONFIG_USB_DEVICE_VID=0xC019
CONFIG_LOG=y
CONFIG_USB_DRIVER_LOG_LEVEL_ERR=y
CONFIG_USB_CDC_ACM=y
CONFIG_USB_DEVICE_LOG_LEVEL_ERR=y
CONFIG_SERIAL=y

CONFIG_UART_INTERRUPT_DRIVEN=y
CONFIG_UART_LINE_CTRL=y
CONFIG_USB_UART_DTR_WAIT=n

# 
CONFIG_BT=y
CONFIG_BT_DEBUG_LOG=y
# CONFIG_BT_SMP=y
#CONFIG_BT_PERIPHERAL=y
CONFIG_BT_BROADCASTER=y
CONFIG_BT_OBSERVER=y

# 
CONFIG_PRINTK=y
CONFIG_HEAP_MEM_POOL_SIZE=256
# CONFIG_ASSERT=y

CONFIG_REBOOT=y

# fs_dirent structures are big.
CONFIG_MAIN_STACK_SIZE=2048
# littlefs
CONFIG_SPI=y
CONFIG_FLASH=y
CONFIG_FLASH_MAP=y
CONFIG_FLASH_PAGE_LAYOUT=y

CONFIG_FILE_SYSTEM=y
CONFIG_FILE_SYSTEM_LITTLEFS=y

CONFIG_UART_CONSOLE_INIT_PRIORITY=91
CONFIG_USE_SEGGER_RTT=y
CONFIG_RTT_CONSOLE=y
CONFIG_SEGGER_SYSTEMVIEW=y

CONFIG_COMPILER_OPT="-DSAEWOO_HACK"
```

## boards/nrf52840dongle_nrf52840.conf
```kconfig
#
# Copyright (c) 2019 Peter Bigot Consulting, LLC
# Copyright (c) 2019 Nordic Semiconductor ASA
#
# SPDX-License-Identifier: Apache-2.0
#

# Need this when storage is on flash
# CONFIG_MPU_ALLOW_FLASH_WRITE=y

# Need this when storage is on MX25R64
CONFIG_NORDIC_QSPI_NOR=y
CONFIG_NORDIC_QSPI_NOR_FLASH_LAYOUT_PAGE_SIZE=4096
```

## boards/nrf52840dk_nrf52840.overlay
```dts
/*
 * Copyright (c) 2019 Peter Bigot Consulting, LLC
 *
 * SPDX-License-Identifier: Apache-2.0
 */

/delete-node/ &storage_partition;

&mx25r64 {
	partitions {
		compatible = "fixed-partitions";
		#address-cells = <1>;
		#size-cells = <1>;

		partition@0 {
			label = "storage";
			reg = <0x00000000 0x00100000>;
		};
	};
};
```

## src/main.c
```c
/* main.c - Application main entry point */

/*
 * Copyright (c) 2015-2016 Intel Corporation
 *
 * SPDX-License-Identifier: Apache-2.0
 */

#include <zephyr/types.h>
#include <stddef.h>
#include <sys/printk.h>
#include <sys/util.h>

#include <bluetooth/bluetooth.h>
#include <bluetooth/hci.h>

#include "led.h"
#include "led_global.h"
#include "stdio.h"

#include <sys/ring_buffer.h>
#include <usb/usb_device.h>
#include <drivers/uart.h>

#include <time.h>
// includes for files
#include <fs/fs.h>
#include <fs/littlefs.h>
#include <storage/flash_map.h>
#ifdef ENCOUNTER
#include "encounter.h"
#endif
bool bt_started=false;
bool start_adv=false;
bool cdc_open=false;
bool write_flash=false;
bool flash_full=false;
bool show_raw=false;
bool show_binary=true;
bool show_kernel=false;
bool usb_error=false;

extern void button_init(void);
extern void bt_init(void);
extern void start_scan(void);
extern void stop_scan(void);
extern void bt_adv(void);
extern void parse_command(char c);
#define STACKSIZE 1024

struct bt_le_scan_param scan_param = {
    .type       = BT_HCI_LE_SCAN_PASSIVE,
    .options    = BT_LE_SCAN_OPT_NONE,
    .interval   = 0x1000,
    .window     = 0x0200,
};

#define RING_BUF_SIZE 1024
u8_t in_ring_buffer[RING_BUF_SIZE];
u8_t out_ring_buffer[RING_BUF_SIZE];
u8_t flash_ring_buffer[8192];

struct device *cdc_dev;
struct ring_buf inringbuf;
struct ring_buf outringbuf;
struct ring_buf flashringbuf;

struct device *button_dev;

#define MAX_PATH_LEN 255

#define LINE_LENGTH 100
FS_LITTLEFS_DECLARE_DEFAULT_CONFIG(storage);
static struct fs_mount_t lfs_storage_mnt = {
.type = FS_LITTLEFS,
.fs_data = &storage,
.storage_dev = (void *)DT_FLASH_AREA_STORAGE_ID,
.mnt_point = "/lfs",
};

struct fs_mount_t *mp = &lfs_storage_mnt;
struct fs_file_t encounter_file;
extern int flash_init(void);
extern void flash_close(void);
extern void ls(void);
extern void encounter_info(void);

uint32_t minute_timestamp=0;

uint8_t private_key[32];
uint8_t public_key[32];
uint8_t shared_key[32];
uint32_t next_minute;
uint32_t epochtimesync;
uint32_t offsettime=0;
uint8_t saewoo_hack[2];
#ifdef ENCOUNTER
Encounter_record encounters[64];
#endif
uint32_t c_fifo_last_idx=0;
uint32_t p_fifo_start_idx=0;
uint32_t p_fifo_last_idx=0;

bool hide_mac = true;
int ret_flash;
uint8_t mac_addr[6];

void cdc_init(void)
{
    printk("cdc_init\n");
    cdc_dev = device_get_binding("CDC_ACM_0");
    if (!cdc_dev) {
        printk("CDC ACM device not found\n");
        return;
    }
}
void usb_init(void) {
    // ret = usb_enable(usb_status_cb);
    int ret = usb_enable(NULL);
    printk("usb_init\n");
    if (ret != 0) {
        printk("Failed to enable USB\n");
        return;
    }
}

u8_t flash_buffer[4096];
int total_written=0;
int total_cache=0;
// #define CHUNK 4000

K_THREAD_DEFINE(bt_adv_id, STACKSIZE, bt_adv, NULL, NULL, NULL,
            3, 0, 0);

static void cdc_interrupt_handler(struct device *dev)
{
    while (uart_irq_update(dev) && uart_irq_is_pending(dev)&&(usb_error==0)) {
        if (uart_irq_rx_ready(dev)) {
            int recv_len, rb_len;
            u8_t buffer[64];
            size_t len = MIN(ring_buf_space_get(&inringbuf),
                     sizeof(buffer));

            recv_len = uart_fifo_read(dev, buffer, len);

            rb_len = ring_buf_put(&inringbuf, buffer, recv_len);
            if (rb_len < recv_len) {
                printk("Drop %u bytes\n", recv_len - rb_len);
            }

            // LOG_DBG("tty fifo -> inringbuf %d bytes", rb_len);
        }

        if (uart_irq_tx_ready(dev)) {
            u8_t buffer[64];
            int rb_len, send_len;

            unsigned int key = irq_lock();
            rb_len = ring_buf_get(&outringbuf, buffer, sizeof(buffer));
            irq_unlock(key);
            if (!rb_len) {
                // LOG_DBG("Ring buffer empty, disable TX IRQ");
                uart_irq_tx_disable(dev);
                continue;
            }

            send_len = uart_fifo_fill(dev, buffer, rb_len);
            if (send_len < rb_len) {
                printk("Drop %d bytes\n", rb_len - send_len);
            }

            // LOG_DBG("outringbuf -> tty fifo %d bytes", send_len);
        }
    }
}
void dtr_init(void) {
    u32_t baudrate, dtr = 0U;
    int ret;

    printk("Wait for DTR");
    while (true) {
        uart_line_ctrl_get(cdc_dev, UART_LINE_CTRL_DTR, &dtr);
        if (dtr) {
            break;
        } else {
            /* Give CPU resources to low priority threads. */
            k_sleep(K_MSEC(100));
        }
    }
    printk("DTR set");

    /* They are optional, we use them to test the interrupt endpoint */
    ret = uart_line_ctrl_set(cdc_dev, UART_LINE_CTRL_DCD, 1);
    if (ret) {
        printk("Failed to set DCD, ret code %d", ret);
    }

    ret = uart_line_ctrl_set(cdc_dev, UART_LINE_CTRL_DSR, 1);
    if (ret) {
        printk("Failed to set DSR, ret code %d", ret);
    }

    /* Wait 1 sec for the host to do all settings */
    k_busy_wait(1000000);

    ret = uart_line_ctrl_get(cdc_dev, UART_LINE_CTRL_BAUD_RATE, &baudrate);
    if (ret) {
        printk("Failed to get baudrate, ret code %d", ret);
    } else {
        printk("Baudrate detected: %d\n", baudrate);
    }

    uart_irq_callback_set(cdc_dev, cdc_interrupt_handler);

    /* Enable rx interrupts */
    uart_irq_rx_enable(cdc_dev);
}

void clear_encounter(void) {
    int rc;
    char fname[MAX_PATH_LEN];
    bool pause = write_flash;

    write_flash = false;
    //  Wait to finish any writes...

    //
    snprintf(fname, sizeof(fname), "%s/encounters", mp->mnt_point);
    rc = fs_close(&encounter_file);
    printk("close rc: %d\n", rc);
    // delete file with "unlink"
    rc = fs_unlink(fname);
    printk("unlink rc: %d\n", rc);

    rc = fs_open(&encounter_file, fname);
    if (rc < 0) {
        printk("FAIL: open %s: %d\n", fname, rc);
        return;
    }
    write_flash = pause;
    flash_full = false;
}

void uart_print(char *buffer, int len){
    unsigned int key = irq_lock();
    ring_buf_put(&outringbuf, buffer, len);
    irq_unlock(key);
    uart_irq_tx_enable(cdc_dev);
}

void uart_printf(char *format, ...) {

    va_list arg;
    va_start(arg, format);
    int len;
    static char buffer[64];

    len = vsnprintf(buffer, 64,format, arg);

    unsigned int key = irq_lock();
    ring_buf_put(&outringbuf, buffer, len);
    irq_unlock(key);
    uart_irq_tx_enable(cdc_dev);
}

void write_time (uint32_t local, uint32_t rawtime) {
    int rc;
    char fname[MAX_PATH_LEN];
    struct fs_file_t time_file;

    snprintf(fname, sizeof(fname), "%s/timeinfo", mp->mnt_point);

    rc = fs_open(&time_file, fname);
    if (rc < 0) {
        uart_printf("FAIL: open %s: %d\n", fname, rc);
        return;
    }

    //     rc = fs_read(&file, &boot_count, sizeof(boot_count));
    //     printk("%s read count %u: %d\n", fname, boot_count, rc);

    rc = fs_write(&time_file, &local, sizeof(local));
    rc = fs_write(&time_file, &rawtime, sizeof(rawtime));
    rc = fs_close(&time_file);
}

void read_time(uint32_t *local, uint32_t *rawtime) {
    int rc;
    char fname[MAX_PATH_LEN];
    struct fs_file_t time_file;

    snprintf(fname, sizeof(fname), "%s/timeinfo", mp->mnt_point);

    rc = fs_open(&time_file, fname);
    if (rc < 0) {
        uart_printf("FAIL: open %s: %d\n", fname, rc);
        return;
    }

    rc = fs_read(&time_file, local, 4);
    rc = fs_read(&time_file, rawtime, 4);
    rc = fs_close(&time_file);

}

void got_g(void) {
    struct fs_file_t file;
    char line[128];
    char fname[MAX_PATH_LEN];
    int rc;
    int total_bytes = 0;
    int pos = 0;
    int record_length = 0;
    int out_len = 0;
    memset(line, 0, 128);

    if (show_binary) {
        record_length = 32;
    } else {
        record_length = 100;
    }

    snprintf(fname, sizeof(fname), "%s/encounters", mp->mnt_point);

    rc = fs_open(&file, fname);
    if (rc < 0) {
        printk("FAIL: open %s: %d\n", fname, rc);
        return;
    }
    printk("Opened file rc: %d\n", rc);
    int line_count = 0;
    while((rc = fs_read(&file, line, record_length))) {
        line[rc] = 0;
        if (rc == record_length) {
            unsigned int key = irq_lock();
            out_len = ring_buf_put(&outringbuf, line, rc);
            irq_unlock(key);
            uart_irq_tx_enable(cdc_dev);
            if (out_len < rc) {
                uart_printf("problem got_g, out_len: %d, line_len: %d\n", out_len, rc);
            }

            total_bytes += out_len;
            line_count++;
        }
    }
    pos = fs_tell(&file);
    rc = fs_close(&file);
    // printk("Close file rc: %d\n", rc);
    uart_printf("total_bytes: %d, line_count: %d\n", total_bytes, line_count);
    // uart_print(line, rc);
}

void cleanup_cache(void) {
    int total_len;
    // unsigned int key;
    char buffer[64];
    int len;
    int record_length, number_of_events;
    if (show_binary) {
        record_length = 32;
    } else {
        record_length = 100;
    }

    total_len = ring_buf_get(&flashringbuf, flash_buffer, 4096);

    // len = sprintf(buffer, "total_written:  %d, total_cache: %d left: %d\n",
    //         total_written, total_cache, total_len);
    // uart_print(buffer, len);

    ring_buf_reset(&flashringbuf);

    number_of_events = total_len / record_length;
    total_len = number_of_events * record_length; 

    // len = sprintf(buffer, "len to write to file: %d\n", total_len);
    // uart_print(buffer, len);

    int len_written = fs_write(&encounter_file, flash_buffer, total_len);
    fs_sync(&encounter_file);
    total_written += len_written;

    uart_printf( "cleanup cache total_written:  %d, total_cache: %d\n",
            total_written, total_cache);
    // len = sprintf(buffer, "cleanup cache total_written:  %d, total_cache: %d\n",
    //         total_written, total_cache);
    // uart_print(buffer, len);
}

void flash_store(void) {
    int space;
    int total_len = 0;
    int len_written;
    int CHUNK = 0;

    if (show_binary) {
        CHUNK = 2048;
    } else {
        CHUNK = 4000;
    }

    space = ring_buf_space_get(&flashringbuf);
    if (!write_flash) {
        if (space<8191) {
            cleanup_cache();
        }
    } else {
        ;
        /* char buffer[64]; */
        /* int len = sprintf(buffer, "flash_store: total_written:  %d, total_cache: %d\n", */
        /*         total_written, total_cache); */
        /* uart_print(buffer, len); */
        /*
        printk("Space: %d, total_written: %d, total_cache: %d\n", 
                space, total_written, total_cache);
                */
    } 
    if (space < (8191-CHUNK)) {
        flash(&led4);
        /*
        do {
            total_len += ring_buf_get(&flashringbuf, flash_buffer, CHUNK);
        } while (total_len<CHUNK);
        */
        total_len += ring_buf_get(&flashringbuf, flash_buffer, CHUNK);
        len_written = fs_write(&encounter_file, flash_buffer, CHUNK);
        fs_sync(&encounter_file);
        total_written += len_written;
        printk("Space: %d, total_written: %d, total_cache: %d\n", 
                space, total_written, total_cache);
        if (len_written < CHUNK) {
            printk("Disk full???\n");
        }
    }
}

/*
void parse_command(char c) {
    const char *version_str = "Version: " __DATE__ " " __TIME__;
    // int total_len, len_written;
            switch (c) {
                case 'y':  // start_scan
                    {
                    start_scan();
                    break;
                    }
                case 'x':  // stop_scan
                    {
                    stop_scan();
                    break;
                    }
                case 'v': // change scan params
                    {
                    uint16_t interval, window;
                    int len = 0;
                    do {
                        len += ring_buf_get(&inringbuf, (uint8_t *)&(interval)+len, 1);
                    } while (len < 2);
                    len =0;
                    do {
                        len += ring_buf_get(&inringbuf, (uint8_t *)&(window)+len, 1);
                    } while (len < 2);

                    // uart_printf("interval %u, window: %u\n", interval, window);
                    scan_param.interval = interval;
                    scan_param.window = window;
                    break;
                    }
                case 'e':  // resume adv thread
                    {
                    //  thread_resume/suspend doesn't seem to work
                    //k_thread_resume(bt_adv_id);
                    start_adv = true;
                    break;
                    }
                case 'd':  // suspend adv thread
                    {
                    //  thread_resume/suspend doesn't seem to work
                    //k_thread_suspend(bt_adv_id);
                    start_adv = false;
                    break;
                    }
                case 'i': 
                    {
                    uart_printf("start_adv:%d, raw:%d, binary:%d, write_flash:%d, hide:%d\n", 
                            start_adv, show_raw, show_binary, write_flash, hide_mac);
                    break;
                    }
                case 'g':  // Get all data from FLASH
                    {
                    printk("got g\n");
                    got_g();
                    break;
                    }
                case 'c':  // Clear flash memory
                    {
                    printk("got c\n");
                    clear_encounter();
                    // clear variable keeping track of what is written
                    total_written = 0;
                    total_cache = 0;
                    printk("done clear\n");
                    break;
                    }
                case 'k':  // Show data on printk/debugger
                    printk("got k\n");
                    show_kernel = !show_kernel ;
                    break;
                case 'r':  // Show data on USB_SERIAL PORT
                    printk("got r\n");
                    show_raw = true ;
                    break;
                case 'z':  // Stop data on USB_SERIAL PORT
                    printk("got z\n");
                    show_raw = false ;
                    break;
                case 'l':  // list files to debugger
                    {
                    printk("got l\n");
                    ls();
                    break;
                    }
                case 'w':  // Write data to flash
                    printk("got w\n");
                    write_flash = true ;
                    break;
                case 's':  // Stop write data to flash
                    {
                    printk("got s\n");
                    write_flash = false;
                    cleanup_cache();
                    // encounter_info();

                    break;
                    }
                case 'f': // get info about flash and cache
                    {
                    char buffer[64];
                    int len = sprintf(buffer, "init: %d, total_written:  %d, total_cache: %d\n",
                            ret_flash, total_written, total_cache);
                    uart_print(buffer, len);
                    break;
                    }
                case 'b':  // output data as binary
                    printk("got b\n");
                    show_binary = true ;
                    break;
                case 'n':  // output data as text
                    printk("got n\n");
                    show_binary = false ;
                    break;
                case 'u':  // get timestamp
                    {
                    uint32_t local, human;
                    read_time(&local, &human); 
                    uart_printf("%u, %u\n", local, human);
                    // printk("got u\n");
                    break;
                    }
                case 't':  // get timestamp
                    {
                    printk("got t\n");
                    int len = 0;
                    // char buffer[64];
                    uint32_t timestamp = k_uptime_get_32();
                    uint8_t *temp = (uint8_t *) &epochtimesync;
                    //  Have to get 1 byte at a time...
                    do {
                        len += ring_buf_get(&inringbuf, temp+len, 1);
                    } while (len < 4);

                    // len=sprintf(buffer, "%u, %u\n", epochtimesync, timestamp);
                    // uart_print(buffer, len);
                    write_time(timestamp, epochtimesync);
                    offsettime = timestamp;
                    struct tm ts;
                    time_t rawtime = (const time_t) epochtimesync;
                    ts = *gmtime(&rawtime);
                    int delta = 60 - ts.tm_sec;
                    if (delta <= 0) {
                        delta += 60;
                    }
                    next_minute = timestamp + delta * 1000;
                    break;
                    }
                case 'j':
                    uart_printf("scan interval %u, window: %u\n", 
                            scan_param.interval, scan_param.window);
                    #ifdef ENCOUNTER
                    uart_printf("sizeof encounter struct: %d\n", sizeof(Encounter_record));
                    #endif
                    break;
                case 'a':
                    {
                    printk("got a\r");
                    uint32_t timestamp = k_uptime_get_32();
                    printk("timestamp: %d\r", timestamp);
                    unsigned int key = irq_lock();
                    ring_buf_put(&outringbuf,(uint8_t *) &timestamp, 4);
                    irq_unlock(key);
                    uart_irq_tx_enable(cdc_dev);
                    break;
                    }
                case 'h':
                    uart_printf("%s\n", version_str);
                    break;
                case 'm': // Send MAC address
                    {
                    unsigned int key = irq_lock();
                    ring_buf_put(&outringbuf,(uint8_t *) mac_addr, 6);
                    irq_unlock(key);
                    uart_irq_tx_enable(cdc_dev);
                    break;
                    }
                case 'o':
                    {
                    // uint32_t epochtimesync;
                    // uint32_t offsettime;
                    int len=0;
                    uint8_t *temp;
                    temp = (uint8_t *) &epochtimesync;
                    //  Have to get 1 byte at a time...
                    do {
                        len += ring_buf_get(&inringbuf, temp+len, 1);
                    } while (len < 4);
                    len = 0;
                    temp = (uint8_t *) &offsettime;
                    //  Have to get 1 byte at a time...
                    do {
                        len += ring_buf_get(&inringbuf, temp+len, 1);
                    } while (len < 4);
                    uart_printf("%u %u\n", epochtimesync, offsettime);
                    write_time(offsettime, epochtimesync);
                    break;
                    }
                case 'p':
                    hide_mac = false;
                    break;
                case 'q':
                    hide_mac = true;
                    break;
                default:
                    {
                    printk("got %c, not defined\n", c);
                    break;
                    }
            }
}
*/

void main(void)
{
    // int err;
    led_init(&led1);
    led_init(&led2);
    led_init(&led3);
    led_init(&led4);
    for (int i=0; i<5; i++){
        flash(&led1);
        flash(&led2);
        flash(&led3);
        flash(&led4);
    }
    button_init();
    // printk("Starting Scanner/Advertiser Demo\n");
    ring_buf_init(&inringbuf, sizeof(in_ring_buffer), in_ring_buffer);
    ring_buf_init(&outringbuf, sizeof(out_ring_buffer), out_ring_buffer);
    ring_buf_init(&flashringbuf, sizeof(flash_ring_buffer), flash_ring_buffer);
    ret_flash = flash_init();
    for (int i=0; i<5; i++){
        flash(&led1);
    }
    // printk("Bluetooth initialized\n");
    bt_init();
    // start_adv = true;
    // There is a thread that runs the bt_adv
    // bt_adv();
    //
    start_scan();
    // 
    // Try to figure out mac address
    //
    bt_addr_le_t a[CONFIG_BT_ID_MAX];
    int count;
    bt_id_get(a, &count);
    // First entry is probably mac address
    memcpy(mac_addr, a->a.val, 6);

    cdc_init();
    usb_init();
    dtr_init();
    cdc_open=true;
    u8_t c;
    while (true) {
        while(ring_buf_get(&inringbuf, &c, 1)){
            parse_command(c);
        }
        flash_store();
        k_sleep(K_MSEC(2000));

    }
}

/* scratch work
 *
                    char buffer[64];
                    int len=sprintf(buffer, "%d: got l\n", counter++);
                    // printk("Trying to send: %s", buffer);

                    unsigned int key = irq_lock();
                    int out_len = ring_buf_put(&outringbuf, buffer, len);
                    irq_unlock(key);
                    // printk("out_len: %d\n", out_len);
                    uart_irq_tx_enable(cdc_dev);
                    // cdc_printf("%d: got l\n", counter++);

 *
 */
```

## src/bt.c
```c
#include <zephyr/types.h>
#include <stddef.h>
#include <sys/printk.h>
#include <sys/util.h>

#include <bluetooth/bluetooth.h>
#include <bluetooth/hci.h>
#include <stdio.h>

#define RPI_PERIOD 10000  // mSec
#include "led.h"
#include <drivers/uart.h>
#include <sys/ring_buffer.h>

#include <fs/fs.h>

extern void rpi_init(u8_t *rpi);
extern void rpi_update(u8_t *rpi);
extern void cdc_printf(char *format, ...);

extern bool bt_started;
extern bool start_adv;
extern bool cdc_open;
extern bool write_flash;
extern bool flash_full;
extern bool show_binary;
extern bool show_raw;
extern bool show_kernel;
extern struct bt_le_scan_param scan_param ;
extern struct device *cdc_dev;
extern struct ring_buf outringbuf;
extern struct ring_buf flashringbuf;
extern struct fs_file_t encounter_file;
extern int total_cache;

extern uint8_t saewoo_hack[2];

#define BT_LE_ADV_NCONN2 BT_LE_ADV_PARAM(4, BT_GAP_ADV_FAST_INT_MIN_2, \
                                        BT_GAP_ADV_FAST_INT_MAX_2, NULL)

void bt_init(void) {
    int err;
    printk("Starting Scanner/Advertiser Demo\n");

    /* Initialize the Bluetooth Subsystem */
    err = bt_enable(NULL);
    if (err) {
        printk("Bluetooth init failed (err %d)\n", err);
        // blink(&led2, 1);
        return;
    }
    bt_started = true;
    printk("Bluetooth initialized\n");
}


void bt_adv (void) {
    u8_t *tcn;
    struct bt_data encounter_ad[] = {
            BT_DATA_BYTES(BT_DATA_FLAGS, BT_LE_AD_NO_BREDR),
            // BT_DATA_BYTES(BT_DATA_TX_POWER, 0),
            BT_DATA_BYTES(BT_DATA_UUID16_ALL, 0x6F, 0xFD),
            BT_DATA_BYTES(BT_DATA_SVC_DATA16,
                            0x6F, 0xFD,
                            0,0,0,0,0,0,0,0,
                            0,0,0,0,0,0,0,0,
                            0x04, 0x3, 0x2, 0x1)
    };
    while (!start_adv) {
        printk("BT not started\n");
        k_sleep(K_MSEC(1000));
    } 
    printk("Trying to start advertising\n");

    tcn = encounter_ad[2].data+2; // 3rd item in array of messages is RPI
    rpi_init(tcn);
    // u32_t round=0;
    k_sleep(K_MSEC(400));

    /* Start advertising */
    /*
     *
     *  We will move start into the loop to change the address repeatably
     *  For now, outside the loop so that it is easier to debug and use in BT
     *  tests
     *
     */
    rpi_update(tcn);
    int err = bt_le_adv_start(BT_LE_ADV_NCONN2, encounter_ad,
                            ARRAY_SIZE(encounter_ad), NULL, 0);
    if (err) {
        printk("Advertising failed to start (err %d)\n", err);
        return;
    }

    do {
        blink(&led1,1);
        if (write_flash) {
            blink(&led2,1);
        }
        if (!start_adv) {
            bt_le_adv_stop();

            while (!start_adv) {
                k_sleep(K_MSEC(1000));
            }
            int err = bt_le_adv_start(BT_LE_ADV_NCONN2, encounter_ad,
                                    ARRAY_SIZE(encounter_ad), NULL, 0);
            if (err) {
                printk("Advertising failed to start (err %d)\n", err);
                return;
            }
        }

        k_sleep(K_MSEC(RPI_PERIOD));
        rpi_update(tcn);
        err = bt_le_adv_update_data(encounter_ad, ARRAY_SIZE(encounter_ad), NULL, 0);
        /*  Will not use update... but stop in version that randomized MAC */
        // err = bt_le_adv_stop();
        if (err) {
            printk("Advertising failed to stop (err %d)\n", err);
            return;
        }
        printk("Update rpi\n");
    } while (1);
}

/*
static bool data_cb(struct bt_data *data, void *user_data)
{
    u8_t *uuid16 = user_data;

    switch (data->type) {
    case BT_DATA_UUID16_ALL:
        memcpy(uuid16, data->data, 2);
        return false;
    default:
        return true;
    }
}
*/
/*
static void scan_cb(const bt_addr_le_t *addr, s8_t rssi, u8_t adv_type,
            struct net_buf_simple *buf)
{
    char buffer[60];
    char line[1024];
    u8_t uuid16[2]={0, 0};
    u8_t size = 0;

    u32_t timestamp = k_uptime_get_32();
    flash(&led2);
    for (u8_t i=0; i<buf->len; i++) {
        size += sprintf(buffer+size, "%02x", buf->data[i]);
    }
    bt_data_parse(buf, data_cb, uuid16);
    if ((uuid16[0]==0x6F) && (uuid16[1]==0xFD)) {
        // flash(&led2);
        char addr_string[BT_ADDR_LE_STR_LEN];
        bt_addr_le_to_str(addr, addr_string, sizeof(addr_string));
        if (write_flash) {
            sprintf(line, "%12u, %3d, %s, %s\n", timestamp, rssi, addr_string, buffer);
            printk("line len: %d\n", strlen(line));
        }
        if (show_raw && cdc_open) {
            printk("%12u, %3d, %s, %s\n", timestamp, rssi, addr_string, buffer);
        }
    }
}
*/

static bool data_cb_local(struct bt_data *data, void *user_data)
{
    u8_t *uuid16 = user_data;

    switch (data->type) {
    case BT_DATA_UUID16_ALL:
        memcpy(uuid16, data->data, 2);
        return false;
    default:
        return true;
    }
}

static void scan_cb_orig(const bt_addr_le_t *addr, s8_t rssi, u8_t adv_type,
            struct net_buf_simple *buf)
{
    // flash(&led2);
    u8_t uuid16[2] = {0, 0};
    u32_t timestamp = k_uptime_get_32();
    uint8_t raw_event[32];
    char rpi_string[64];
    int size = 0;
    for(u8_t i=0; i<buf->len; i++) {
        size += sprintf(rpi_string+size, "%02X", buf->data[i]);
    }

    bt_data_parse(buf, data_cb_local, uuid16);
    if ((uuid16[0]==0x6F) && (uuid16[1]==0xFD)) {
        flash(&led2);
        char addr_string[20];
        memcpy(raw_event,(uint8_t *) &timestamp, 4);
        memcpy(raw_event+4, addr->a.val, 6);
        // raw_event[10] = 0xFF;
        raw_event[10] = saewoo_hack[0]+37;
        raw_event[11] = rssi;
        memcpy(raw_event+12, buf->data+6, 20);  // skip 0x6FFD patterns
        if (show_binary) {
            if (show_raw) {
                unsigned int key = irq_lock();
                ring_buf_put(&outringbuf, raw_event, 32);
                irq_unlock(key);
                uart_irq_tx_enable(cdc_dev);
            }
            if (write_flash) {  // write to flash
                if (ring_buf_space_get(&flashringbuf)>= 32) {  // enough space to write
                    int out_len = ring_buf_put(&flashringbuf, raw_event, 32);
                    if (out_len != 32) {
                        char line[64];
                        int len = sprintf(line, "flash write len: %d space: %d\n", 
                                            out_len, ring_buf_space_get(&flashringbuf));
                        // int len = sprintf(buffer, "flash_store: total_written:  %d, total_cache: %d\n", */
                        //          total_written, total_cache); */
                        unsigned int key = irq_lock();
                        ring_buf_put(&outringbuf, line, len);
                        irq_unlock(key);
                        uart_irq_tx_enable(cdc_dev);
                    }
                total_cache += out_len;
                }
            }
        } else {
            size = 0;
            // reverse the order b/c BT is little-endian
            for(u8_t i=0; i<5; i++) {
                size += sprintf(addr_string+size, "%02X:", addr->a.val[5-i]);
            }
            size += sprintf(addr_string+size, "%02X", addr->a.val[0]);
            char line[128];
            int line_len = sprintf(line, "%11d,%3d,%2d,%s,%s\n",
                            timestamp, rssi, saewoo_hack[0]+37, addr_string, rpi_string);

            if (show_kernel) {  // This puts it on the debugger
                printk("%s", line);
            }
            if (cdc_open&&show_raw) {  // This puts it on the debugger
                unsigned int key = irq_lock();
                int out_len = ring_buf_put(&outringbuf, line, line_len);
                irq_unlock(key);
                // printk("out_len: %d\n", out_len);
                uart_irq_tx_enable(cdc_dev);
                key=irq_lock();
                out_len = ring_buf_put(&outringbuf, raw_event, 32);
                irq_unlock(key);
                uart_irq_tx_enable(cdc_dev);
            }
            if (write_flash) {  // write to flash
                int out_len = ring_buf_put(&flashringbuf, line, line_len);
                total_cache += out_len;
            }
            // printk("ring space: %d\n", ring_buf_space_get(&flashringbuf));
            // printk("ring capacity: %d\n", ring_buf_capacity_get(&flashringbuf));

            /*
            unsigned int key = irq_lock();
            int len_written = fs_write(&encounter_file, line, line_len);
            printk("%d, ", len_written);
            int rc = fs_sync(&encounter_file);
            printk("%d\n", rc);
            irq_unlock(key);
            // k_sleep(K_MSEC(50));

            if (rc<0) {
                printk("ERROR in trying to fsync\n");
            }
            if (len_written < 0) {
                printk("ERROR in writing\n");
            } else if (len_written < line_len) {
                printk("len_written: %d, line_len: %d Flash full\n",
                        len_written, line_len);
                flash_full = true;
                blink(&led4, 20);
            }
            */
        }
    }
}


void start_scan(void) {
    //  Start Scan
    int err = bt_le_scan_start(&scan_param, scan_cb_orig);
    if (err) {
        printk("Starting scanning failed (err %d)\n", err);
        return;
    } else {
        printk("Scan started\n");
    }

}

void stop_scan(void) {
    int err = bt_le_scan_stop();
    if (err) {
        printk("Stop scanning failed (err %d)\n", err);
        return;
    } else {
        printk("Scan stopped\n");
    }
}
```

## src/button.c
```c
#include "led.h"
#include <stdio.h>
#include <string.h>
#include <sys/ring_buffer.h>
#include <drivers/uart.h>
#include <fs/fs.h>
#include <fs/littlefs.h>
#include <storage/flash_map.h>

extern struct device *cdc_dev;
extern struct ring_buf outringbuf;

extern struct device *button_dev;
extern bool write_flash;
extern int total_written;
extern int total_cache;
extern struct ring_buf flashringbuf;
extern u8_t *flash_buffer;

extern struct fs_file_t encounter_file;

void uart_print(char *buffer, int len);

void button_pressed(struct device *dev, struct gpio_callback *cb,
            u32_t pins)
{

    write_flash = !write_flash;
    // Flash led crashes things here...???
    // 
    //  This doesn't work all the time... Better with irq_lock
    // char buffer[64];
    // int len = sprintf(buffer, "write_flash: %d\n", write_flash);
    // uart_print(buffer, len);
}

void button_init(void){
    int ret;
    static struct gpio_callback button_cb_data;

    button_dev = device_get_binding(DT_ALIAS_SW0_GPIOS_CONTROLLER);
    if (button_dev == NULL) {
        return;
    }

    ret = gpio_pin_configure(button_dev, DT_ALIAS_SW0_GPIOS_PIN,
                 DT_ALIAS_SW0_GPIOS_FLAGS | GPIO_INPUT);
    if (ret != 0) {
        return;
    }

    ret = gpio_pin_interrupt_configure(button_dev, DT_ALIAS_SW0_GPIOS_PIN,
                       GPIO_INT_EDGE_TO_ACTIVE);
    if (ret != 0) {
        return;
    }

    gpio_init_callback(&button_cb_data, button_pressed,
               BIT(DT_ALIAS_SW0_GPIOS_PIN));
    gpio_add_callback(button_dev, &button_cb_data);

}
```

## src/file.c
```c
// includes for files
#include <fs/fs.h>
#include <fs/littlefs.h>
#include <storage/flash_map.h>
#include <stdio.h>
#include <sys/ring_buffer.h>
#include <drivers/uart.h>

#define MAX_PATH_LEN 255

extern struct fs_mount_t *mp;
extern struct fs_file_t encounter_file;
extern bool flash_full;
extern bool write_flash;
extern struct device *cdc_dev;
extern struct ring_buf outringbuf;

extern void uart_printf(char *format, ...);

void flash_close();

int flash_init(void) {
    unsigned int id = (uintptr_t)mp->storage_dev;
    const struct flash_area *pfa;
    int rc;
    char fname[MAX_PATH_LEN];
    struct fs_statvfs sbuf;

    rc = flash_area_open(id, &pfa);
    if (rc < 0) {
        printk("FAIL: unable to find flash area %u: %d\n",
               id, rc);
        //  Need to add LED blink here to indicate error

        return -1;
    }
    // Print info about flash area
    printk("\nArea %u at 0x%x on %s for %u bytes\n\n",
           id, (unsigned int)pfa->fa_off, pfa->fa_dev_name,
           (unsigned int)pfa->fa_size);

    /* Optional wipe flash contents */
    if (IS_ENABLED(CONFIG_APP_WIPE_STORAGE)) {
        printk("Erasing flash area ... ");
        rc = flash_area_erase(pfa, 0, pfa->fa_size);
        printk("%d\n", rc);
        flash_area_close(pfa);
    }

    rc = fs_mount(mp);
    if (rc < 0) {
        printk("FAIL: mount id %u at %s: %d\n",
               (unsigned int)mp->storage_dev, mp->mnt_point,
               rc);
        return -2;
    }
    printk("%s mount: %d\n", mp->mnt_point, rc);

    
    // Stats about the mountpoint
    rc = fs_statvfs(mp->mnt_point, &sbuf);
    if (rc < 0) {
        printk("FAIL: statvfs: %d\n", rc);
        flash_close();
        return -4;
        // goto out;
    }

    printk("%s: bsize = %lu ; frsize = %lu ;"
           " blocks = %lu ; bfree = %lu\n",
           mp->mnt_point,
           sbuf.f_bsize, sbuf.f_frsize,
           sbuf.f_blocks, sbuf.f_bfree);
    

    struct fs_file_t file;
    struct fs_dirent dirent;

    snprintf(fname, sizeof(fname), "%s/encounters", mp->mnt_point);
    // fetch file info

    rc = fs_stat(fname, &dirent);
    printk("%s stat: %d\n", fname, rc);
    if (rc >= 0) {
        printk("\tfn '%s' siz %u\n", dirent.name, dirent.size);
    }
    // try to open encounter file
    rc = fs_open(&encounter_file, fname);
    if (rc < 0) {
        printk("FAIL: open %s: %d\n", fname, rc);
        flash_close();
        return -3;
        // goto out;
    } else { 
        // jump to end of the file to start writing
        rc = fs_seek(&encounter_file, 0, FS_SEEK_END);
        printk("Jump to end, rc: %d\n", rc);
        printk("address: %x\n",(unsigned int) &encounter_file);
    }

    snprintf(fname, sizeof(fname), "%s/boot_count", mp->mnt_point);
    // Fetch file info
    rc = fs_stat(fname, &dirent);
    printk("%s stat: %d\n", fname, rc);
    if (rc >= 0) {
        printk("\tfn '%s' siz %u\n", dirent.name, dirent.size);
    }


    rc = fs_open(&file, fname);
    if (rc < 0) {
        printk("FAIL: open %s: %d\n", fname, rc);
        return -3;
        // goto out;
    }

    u32_t boot_count = 0;

    if (rc >= 0) {
        rc = fs_read(&file, &boot_count, sizeof(boot_count));
        printk("%s read count %u: %d\n", fname, boot_count, rc);
        rc = fs_seek(&file, 0, FS_SEEK_SET);
        printk("%s seek start: %d\n", fname, rc);

    }

    boot_count += 1;
    rc = fs_write(&file, &boot_count, sizeof(boot_count));
    printk("%s write new boot count %u: %d\n", fname,
           boot_count, rc);

    rc = fs_close(&file);
    printk("%s close: %d\n", fname, rc);

    return 0;
}

void ls(void) {
    struct fs_dir_t dir = { 0 };
    int rc;
    char line[64];
    int line_len;

    rc = fs_opendir(&dir, mp->mnt_point);
    printk("%s opendir: %d\n", mp->mnt_point, rc);

    while (rc >= 0) {
        struct fs_dirent ent = { 0 };

        rc = fs_readdir(&dir, &ent);
        if (rc < 0) {
            break;
        }
        if (ent.name[0] == 0) {
            printk("End of files\n");
            break;
        }
        line_len = sprintf(line, "  %c %u %s\n",
                (ent.type == FS_DIR_ENTRY_FILE) ? 'F' : 'D',
                ent.size,
                ent.name);
        printk("%s", line);
        unsigned int key = irq_lock();
        int out_len = ring_buf_put(&outringbuf, line, line_len);
        irq_unlock(key);
        uart_irq_tx_enable(cdc_dev);
    }

    (void)fs_closedir(&dir);
}

void encounter_info(void) {
    struct fs_dirent dirent;
    char fname[MAX_PATH_LEN];
    int rc;

    snprintf(fname, sizeof(fname), "%s/encounters", mp->mnt_point);
    // fetch file info

    rc = fs_stat(fname, &dirent);
    printk("%s stat: %d\n", fname, rc);
    if (rc >= 0) {
        printk("\tfn '%s' siz %u\n", dirent.name, dirent.size);
    }
}


void flash_close(void) {
    int rc;
    rc = fs_unmount(mp);
    printk("%s unmount: %d\n", mp->mnt_point, rc);
}

 
```

## src/led.h
```c
#ifndef _led_h
#define _led_h
#include <zephyr.h>
#include <device.h>
#include <devicetree.h>
#include <drivers/gpio.h>

struct led {
    const char *gpio_dev_name;
    const char *gpio_pin_name;
    unsigned int gpio_pin;
    unsigned int gpio_flags;
    struct device *dev;
};

#endif
extern struct led led1;
extern struct led led2;
extern struct led led3;
extern struct led led4;
extern void led_init(struct led *led);
extern void blink(struct led *led, uint8_t blink);
extern void flash(struct led *led);
```

## src/parse.c
```c
#include <sys/ring_buffer.h>
#include <bluetooth/bluetooth.h>
#include <time.h>
#include <drivers/uart.h>

extern void start_scan(void);
extern void stop_scan(void);
extern void ls(void);

extern void clear_encounter(void);

extern void uart_printf(char *format, ...);
extern void write_time (uint32_t local, uint32_t rawtime);
extern void read_time(uint32_t *local, uint32_t *rawtime);
extern void got_g(void);
extern void cleanup_cache(void);

extern struct bt_le_scan_param scan_param;

extern bool bt_started;
extern bool start_adv;
extern bool cdc_open;
extern bool write_flash;
extern bool flash_full;
extern bool show_binary;
extern bool show_raw;
extern bool show_kernel;
extern struct bt_le_scan_param scan_param ;
extern struct device *cdc_dev;
extern struct ring_buf outringbuf;
extern struct ring_buf inringbuf;
extern struct ring_buf flashringbuf;
extern struct fs_file_t encounter_file;
extern int total_cache;
extern int total_written;
extern uint32_t next_minute;
extern uint32_t epochtimesync;
extern uint32_t offsettime;

extern bool hide_mac;
extern int ret_flash;
extern uint8_t mac_addr[6];

void parse_command(char c) {
    const char *version_str = "Version: " __DATE__ " " __TIME__;
    // int total_len, len_written;
            switch (c) {
                case 'y':  // start_scan
                    {
                    start_scan();
                    break;
                    }
                case 'x':  // stop_scan
                    {
                    stop_scan();
                    break;
                    }
                case 'v': // change scan params
                    {
                    uint16_t interval, window;
                    int len = 0;
                    do {
                        len += ring_buf_get(&inringbuf, (uint8_t *)&(interval)+len, 1);
                    } while (len < 2);
                    len =0;
                    do {
                        len += ring_buf_get(&inringbuf, (uint8_t *)&(window)+len, 1);
                    } while (len < 2);

                    // uart_printf("interval %u, window: %u\n", interval, window);
                    scan_param.interval = interval;
                    scan_param.window = window;
                    break;
                    }
                case 'e':  // resume adv thread
                    {
                    //  thread_resume/suspend doesn't seem to work
                    //k_thread_resume(bt_adv_id);
                    start_adv = true;
                    break;
                    }
                case 'd':  // suspend adv thread
                    {
                    //  thread_resume/suspend doesn't seem to work
                    //k_thread_suspend(bt_adv_id);
                    start_adv = false;
                    break;
                    }
                case 'i': 
                    {
                    uart_printf("start_adv:%d, raw:%d, binary:%d, write_flash:%d, hide:%d\n", 
                            start_adv, show_raw, show_binary, write_flash, hide_mac);
                    break;
                    }
                case 'g':  // Get all data from FLASH
                    {
                    printk("got g\n");
                    got_g();
                    break;
                    }
                case 'c':  // Clear flash memory
                    {
                    printk("got c\n");
                    clear_encounter();
                    // clear variable keeping track of what is written
                    total_written = 0;
                    total_cache = 0;
                    printk("done clear\n");
                    break;
                    }
                case 'k':  // Show data on printk/debugger
                    printk("got k\n");
                    show_kernel = !show_kernel ;
                    break;
                case 'r':  // Show data on USB_SERIAL PORT
                    printk("got r\n");
                    show_raw = true ;
                    break;
                case 'z':  // Stop data on USB_SERIAL PORT
                    printk("got z\n");
                    show_raw = false ;
                    break;
                case 'l':  // list files to debugger
                    {
                    printk("got l\n");
                    ls();
                    break;
                    }
                case 'w':  // Write data to flash
                    printk("got w\n");
                    write_flash = true ;
                    break;
                case 's':  // Stop write data to flash
                    {
                    printk("got s\n");
                    write_flash = false;
                    cleanup_cache();
                    // encounter_info();

                    break;
                    }
                case 'f': // get info about flash and cache
                    {
                    char buffer[64];
                    // int len = sprintf(buffer, "init: %d, total_written:  %d, total_cache: %d\n",
                    uart_printf("init: %d, total_written:  %d, total_cache: %d\n",
                            ret_flash, total_written, total_cache);
                    // uart_print(buffer, len);
                    break;
                    }
                case 'b':  // output data as binary
                    printk("got b\n");
                    show_binary = true ;
                    break;
                case 'n':  // output data as text
                    printk("got n\n");
                    show_binary = false ;
                    break;
                case 'u':  // get timestamp
                    {
                    uint32_t local, human;
                    read_time(&local, &human); 
                    uart_printf("%u, %u\n", local, human);
                    // printk("got u\n");
                    break;
                    }
                case 't':  // get timestamp
                    {
                    printk("got t\n");
                    int len = 0;
                    // char buffer[64];
                    uint32_t timestamp = k_uptime_get_32();
                    uint8_t *temp = (uint8_t *) &epochtimesync;
                    //  Have to get 1 byte at a time...
                    do {
                        len += ring_buf_get(&inringbuf, temp+len, 1);
                    } while (len < 4);

                    // len=sprintf(buffer, "%u, %u\n", epochtimesync, timestamp);
                    // uart_print(buffer, len);
                    write_time(timestamp, epochtimesync);
                    offsettime = timestamp;
                    struct tm ts;
                    time_t rawtime = (const time_t) epochtimesync;
                    ts = *gmtime(&rawtime);
                    int delta = 60 - ts.tm_sec;
                    if (delta <= 0) {
                        delta += 60;
                    }
                    next_minute = timestamp + delta * 1000;
                    /*
                    len = sprintf(buffer, "Day: %d Month: %d Year: %d\n",
                                    ts.tm_mday, ts.tm_mon, ts.tm_year);
                    uart_print(buffer, len);
                    uint32_t a, b;
                    read_time(&a, &b); 
                    uart_printf("%u, %u\n", a, b);
                    */
                    break;
                    }
                case 'j':
                    uart_printf("scan interval %u, window: %u\n", 
                            scan_param.interval, scan_param.window);
                    #ifdef ENCOUNTER
                    uart_printf("sizeof encounter struct: %d\n", sizeof(Encounter_record));
                    #endif
                    break;
                case 'a':
                    {
                    printk("got a\r");
                    uint32_t timestamp = k_uptime_get_32();
                    printk("timestamp: %d\r", timestamp);
                    unsigned int key = irq_lock();
                    ring_buf_put(&outringbuf,(uint8_t *) &timestamp, 4);
                    irq_unlock(key);
                    uart_irq_tx_enable(cdc_dev);
                    break;
                    }
                case 'h':
                    uart_printf("%s\n", version_str);
                    break;
                case 'm': // Send MAC address
                    {
                    unsigned int key = irq_lock();
                    ring_buf_put(&outringbuf,(uint8_t *) mac_addr, 6);
                    irq_unlock(key);
                    uart_irq_tx_enable(cdc_dev);
                    break;
                    }
                case 'o':
                    {
                    // uint32_t epochtimesync;
                    // uint32_t offsettime;
                    int len=0;
                    uint8_t *temp;
                    temp = (uint8_t *) &epochtimesync;
                    //  Have to get 1 byte at a time...
                    do {
                        len += ring_buf_get(&inringbuf, temp+len, 1);
                    } while (len < 4);
                    len = 0;
                    temp = (uint8_t *) &offsettime;
                    //  Have to get 1 byte at a time...
                    do {
                        len += ring_buf_get(&inringbuf, temp+len, 1);
                    } while (len < 4);
                    uart_printf("%u %u\n", epochtimesync, offsettime);
                    write_time(offsettime, epochtimesync);
                    break;
                    }
                case 'p':
                    hide_mac = false;
                    break;
                case 'q':
                    hide_mac = true;
                    break;
                default:
                    {
                    printk("got %c, not defined\n", c);
                    break;
                    }
            }
}
```
