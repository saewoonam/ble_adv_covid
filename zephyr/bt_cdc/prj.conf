## prj.conf
```kconfig
CONFIG_STDOUT_CONSOLE=y
CONFIG_GPIO=y
CONFIG_USB=y
CONFIG_USB_DEVICE_STACK=y
CONFIG_USB_DEVICE_PRODUCT="CO19 BT Dongle v0.1"
CONFIG_LOG=y
CONFIG_USB_DRIVER_LOG_LEVEL_ERR=y
CONFIG_USB_CDC_ACM=y
CONFIG_USB_DEVICE_LOG_LEVEL_ERR=y
CONFIG_SERIAL=y

CONFIG_UART_INTERRUPT_DRIVEN=y
CONFIG_UART_LINE_CTRL=y
CONFIG_USB_UART_DTR_WAIT=n

# 
CONFIG_BT=y
CONFIG_BT_DEBUG_LOG=y
# CONFIG_BT_SMP=y
#CONFIG_BT_PERIPHERAL=y
CONFIG_BT_BROADCASTER=y
CONFIG_BT_OBSERVER=y

# 
CONFIG_PRINTK=y
CONFIG_HEAP_MEM_POOL_SIZE=256
# CONFIG_ASSERT=y

CONFIG_REBOOT=y
# fs_dirent structures are big.
CONFIG_MAIN_STACK_SIZE=2048
# littlefs
CONFIG_FLASH=y
CONFIG_FLASH_MAP=y
CONFIG_FLASH_PAGE_LAYOUT=y

CONFIG_FILE_SYSTEM=y
CONFIG_FILE_SYSTEM_LITTLEFS=y

CONFIG_UART_CONSOLE_INIT_PRIORITY=91
CONFIG_USE_SEGGER_RTT=y
CONFIG_RTT_CONSOLE=y
CONFIG_SEGGER_SYSTEMVIEW=y
# UF2 settings:
# CONFIG_FLASH_BASE_ADDRESS=0x2000
# CONFIG_USE_CODE_PARTITION
```

## src/main.c
```c
/* main.c - Application main entry point */

/*
 * Copyright (c) 2015-2016 Intel Corporation
 *
 * SPDX-License-Identifier: Apache-2.0
 */

#include <zephyr/types.h>
#include <stddef.h>
#include <sys/printk.h>
#include <sys/util.h>

#include <bluetooth/bluetooth.h>
#include <bluetooth/hci.h>

#include "led.h"
#include "led_global.h"
#include "stdio.h"

#include <sys/ring_buffer.h>
#include <usb/usb_device.h>
#include <drivers/uart.h>

#include <time.h>
bool bt_started=false;
bool start_adv=false;
bool cdc_open=false;
bool write_flash=false;
bool show_raw=false;
bool usb_error=false;

extern void bt_init(void);
extern void start_scan(void);
extern void bt_adv(void);
#define STACKSIZE 1024

struct bt_le_scan_param scan_param = {
    .type       = BT_HCI_LE_SCAN_PASSIVE,
    .options    = BT_LE_SCAN_OPT_NONE,
    .interval   = 0x1000,
    .window     = 0x0200,
};

#define RING_BUF_SIZE 1024
u8_t in_ring_buffer[RING_BUF_SIZE];
u8_t out_ring_buffer[RING_BUF_SIZE];

struct device *cdc_dev;
struct ring_buf inringbuf;
struct ring_buf outringbuf;

void cdc_init(void)
{
    printk("cdc_init\n");
    cdc_dev = device_get_binding("CDC_ACM_0");
    if (!cdc_dev) {
        printk("CDC ACM device not found\n");
        return;
    }
}
void usb_init(void) {
    // ret = usb_enable(usb_status_cb);
    int ret = usb_enable(NULL);
    printk("usb_init\n");
    if (ret != 0) {
        printk("Failed to enable USB\n");
        return;
    }
}

K_THREAD_DEFINE(bt_adv_id, STACKSIZE, bt_adv, NULL, NULL, NULL,
            3, 0, 0);

static void cdc_interrupt_handler(struct device *dev)
{
    while (uart_irq_update(dev) && uart_irq_is_pending(dev)&&(usb_error==0)) {
        if (uart_irq_rx_ready(dev)) {
            int recv_len, rb_len;
            u8_t buffer[64];
            size_t len = MIN(ring_buf_space_get(&inringbuf),
                     sizeof(buffer));

            recv_len = uart_fifo_read(dev, buffer, len);

            rb_len = ring_buf_put(&inringbuf, buffer, recv_len);
            if (rb_len < recv_len) {
                printk("Drop %u bytes\n", recv_len - rb_len);
            }

            // LOG_DBG("tty fifo -> inringbuf %d bytes", rb_len);
        }

        if (uart_irq_tx_ready(dev)) {
            u8_t buffer[64];
            int rb_len, send_len;

            unsigned int key = irq_lock();
            rb_len = ring_buf_get(&outringbuf, buffer, sizeof(buffer));
            irq_unlock(key);
            if (!rb_len) {
                // LOG_DBG("Ring buffer empty, disable TX IRQ");
                uart_irq_tx_disable(dev);
                continue;
            }

            send_len = uart_fifo_fill(dev, buffer, rb_len);
            if (send_len < rb_len) {
                printk("Drop %d bytes\n", rb_len - send_len);
            }

            // LOG_DBG("outringbuf -> tty fifo %d bytes", send_len);
        }
    }
}
void dtr_init(void) {
    u32_t baudrate, dtr = 0U;
    int ret;

    printk("Wait for DTR");
    while (true) {
        uart_line_ctrl_get(cdc_dev, UART_LINE_CTRL_DTR, &dtr);
        if (dtr) {
            break;
        } else {
            /* Give CPU resources to low priority threads. */
            k_sleep(K_MSEC(100));
        }
    }
    printk("DTR set");

    /* They are optional, we use them to test the interrupt endpoint */
    ret = uart_line_ctrl_set(cdc_dev, UART_LINE_CTRL_DCD, 1);
    if (ret) {
        printk("Failed to set DCD, ret code %d", ret);
    }

    ret = uart_line_ctrl_set(cdc_dev, UART_LINE_CTRL_DSR, 1);
    if (ret) {
        printk("Failed to set DSR, ret code %d", ret);
    }

    /* Wait 1 sec for the host to do all settings */
    k_busy_wait(1000000);

    ret = uart_line_ctrl_get(cdc_dev, UART_LINE_CTRL_BAUD_RATE, &baudrate);
    if (ret) {
        printk("Failed to get baudrate, ret code %d", ret);
    } else {
        printk("Baudrate detected: %d\n", baudrate);
    }

    uart_irq_callback_set(cdc_dev, cdc_interrupt_handler);

    /* Enable rx interrupts */
    uart_irq_rx_enable(cdc_dev);
}
void main(void)
{
    // int err;
    led_init(&led1);
    led_init(&led2);
    led_init(&led3);
    led_init(&led4);
    for (int i=0; i<5; i++){
        flash(&led1);
        k_sleep(K_MSEC(200));
    }
    for (int i=0; i<5; i++){
        flash(&led2);
        k_sleep(K_MSEC(200));
    }
    for (int i=0; i<5; i++){
        flash(&led3);
        k_sleep(K_MSEC(200));
    }
    for (int i=0; i<5; i++){
        flash(&led4);
        k_sleep(K_MSEC(200));
    }
    // printk("Starting Scanner/Advertiser Demo\n");
    ring_buf_init(&inringbuf, sizeof(in_ring_buffer), in_ring_buffer);
    ring_buf_init(&outringbuf, sizeof(out_ring_buffer), out_ring_buffer);

    bt_init();
    start_adv = true;
    // printk("Bluetooth initialized\n");
    start_scan();
    // bt_adv();
    cdc_init();
    usb_init();
    dtr_init();
    cdc_open=true;
    u8_t c;
    int counter = 0;
    uint32_t realtime=0;

    while (true) {
        while(ring_buf_get(&inringbuf, &c, 1)){
            switch (c) {
                case 'g':  // Get all data from FLASH
                    {
                    printk("got g\n");
                    // got_g();
                    break;
                    }
                case 'c':  // Clear flash memory
                    {
                    printk("got c\n");
                    // clear_encounter();
                    break;
                    }
                case 'r':  // Show data on USB_SERIAL PORT
                    printk("got r\n");
                    show_raw = true ;
                    break;
                case 'z':  // Show data on USB_SERIAL PORT
                    printk("got z\n");
                    show_raw = false ;
                    break;
                case 'l':  // list files to debugger
                    {
                    printk("got l\n");
                    char buffer[64];
                    int len=sprintf(buffer, "%d: got l\n", counter++);
                    // printk("Trying to send: %s", buffer);

                    unsigned int key = irq_lock();
                    int out_len = ring_buf_put(&outringbuf, buffer, len);
                    irq_unlock(key);
                    // printk("out_len: %d\n", out_len);
                    uart_irq_tx_enable(cdc_dev);
                    // cdc_printf("%d: got l\n", counter++);
                    // ls();
                    break;
                    }
                case 'w':  // Write data to flash
                    printk("got w\n");
                    // write_flash = true ;
                    break;
                case 's':  // Stop write data to flash
                    {
                    printk("got s\n");
                    // write_flash = false;
                    // encounter_info();
                    break;
                    }
                case 't':  // Stop write data to flash
                    {
                    printk("got t\n");
                    int len = 0;
                    char buffer[64];
                    uint32_t timestamp = k_uptime_get_32();
                    uint8_t *temp = (uint8_t *) &realtime;
                    //  Have to get 1 byte at a time...
                    do {
                        len += ring_buf_get(&inringbuf, temp+len, 1);
                        /*
                        sprintf(buffer, "%d\n", len);
                        ring_buf_put(&outringbuf, buffer, strlen(buffer));
                        uart_irq_tx_enable(cdc_dev);
                        k_sleep(K_MSEC(2000));
                        */
                    } while (len < 4);
                    len=sprintf(buffer, "%u, %u\n", realtime, timestamp);
                    unsigned int key = irq_lock();
                    ring_buf_put(&outringbuf, buffer, len);
                    irq_unlock(key);
                    uart_irq_tx_enable(cdc_dev);
                    struct tm ts;
                    time_t rawtime = (const time_t) 0;
                    ts = *gmtime(&rawtime);
                    len = sprintf(buffer, "Day: %d Month: %d Year: %d\n",
                                    ts.tm_mday, ts.tm_mon, ts.tm_year);
                    key = irq_lock();
                    ring_buf_put(&outringbuf, buffer, strlen(buffer));
                    irq_unlock(key);
                    uart_irq_tx_enable(cdc_dev);
 
                    break;
                    }
                default:
                    {
                    printk("got %c, not defined\n", c);
                    break;
                    }
            }
        }
        k_sleep(K_MSEC(2000));

    }
}
```

## src/bt.c
```c
#include <zephyr/types.h>
#include <stddef.h>
#include <sys/printk.h>
#include <sys/util.h>

#include <bluetooth/bluetooth.h>
#include <bluetooth/hci.h>
#include <stdio.h>

#define RPI_PERIOD 10000  // mSec
#include "led.h"
#include <drivers/uart.h>
#include <sys/ring_buffer.h>

extern void rpi_init(u8_t *rpi);
extern void rpi_update(u8_t *rpi);
extern void cdc_printf(char *format, ...);

extern bool bt_started;
extern bool start_adv;
extern bool cdc_open;
extern bool write_flash;
extern bool show_raw;
extern struct bt_le_scan_param scan_param ;
extern struct device *cdc_dev;
extern struct ring_buf outringbuf;
#define BT_LE_ADV_NCONN2 BT_LE_ADV_PARAM(4, BT_GAP_ADV_FAST_INT_MIN_2, \
                                        BT_GAP_ADV_FAST_INT_MAX_2, NULL)
void bt_init(void) {
    int err;
    printk("Starting Scanner/Advertiser Demo\n");
    bt_addr_le_t static_addr;
    static_addr.a.val[5]= 0xF;
    static_addr.type = 1;
    bt_set_id_addr(&static_addr);
    /* Initialize the Bluetooth Subsystem */
    err = bt_enable(NULL);
    if (err) {
        printk("Bluetooth init failed (err %d)\n", err);
        // blink(&led2, 1);
        return;
    }
    bt_started = true;
    printk("Bluetooth initialized\n");
}


void bt_adv (void) {
    u8_t *tcn;
    struct bt_data encounter_ad[] = {
            BT_DATA_BYTES(BT_DATA_FLAGS, BT_LE_AD_NO_BREDR),
            // BT_DATA_BYTES(BT_DATA_TX_POWER, 0),
            BT_DATA_BYTES(BT_DATA_UUID16_ALL, 0x6F, 0xFD),
            BT_DATA_BYTES(BT_DATA_SVC_DATA16,
                            0x6F, 0xFD,
                            0,0,0,0,0,0,0,0,
                            0,0,0,0,0,0,0,0,
                            0x04, 0x3, 0x2, 0x1)
    };
    while (!start_adv) {
        printk("BT not started\n");
        k_sleep(K_MSEC(1000));
    } 
    printk("Trying to start advertising\n");

    tcn = encounter_ad[2].data+2; // 3rd item in array of messages is RPI
    rpi_init(tcn);
    // u32_t round=0;
    k_sleep(K_MSEC(400));

    /* Start advertising */
    /*
     *
     *  We will move start into the loop to change the address repeatably
     *  For now, outside the loop so that it is easier to debug and use in BT
     *  tests
     *
     */
    rpi_update(tcn);
    int err = bt_le_adv_start(BT_LE_ADV_NCONN2, encounter_ad,
                              ARRAY_SIZE(encounter_ad), NULL, 0);
    if (err) {
        printk("Advertising failed to start (err %d)\n", err);
        return;
    }

    do {
        blink(&led1,1);
        k_sleep(K_MSEC(RPI_PERIOD));

        rpi_update(tcn);
        err = bt_le_adv_update_data(encounter_ad, ARRAY_SIZE(encounter_ad), NULL, 0);
        /*  Will not use update... but stop in version that randomized MAC */
        // err = bt_le_adv_stop();
        if (err) {
            printk("Advertising failed to stop (err %d)\n", err);
            return;
        }
        printk("Update rpi\n");
    } while (1);
}

/*
static bool data_cb(struct bt_data *data, void *user_data)
{
    u8_t *uuid16 = user_data;

    switch (data->type) {
    case BT_DATA_UUID16_ALL:
        memcpy(uuid16, data->data, 2);
        return false;
    default:
        return true;
    }
}
*/
/*
static void scan_cb(const bt_addr_le_t *addr, s8_t rssi, u8_t adv_type,
            struct net_buf_simple *buf)
{
    char buffer[60];
    char line[1024];
    u8_t uuid16[2]={0, 0};
    u8_t size = 0;

    u32_t timestamp = k_uptime_get_32();
    flash(&led2);
    for (u8_t i=0; i<buf->len; i++) {
        size += sprintf(buffer+size, "%02x", buf->data[i]);
    }
    bt_data_parse(buf, data_cb, uuid16);
    if ((uuid16[0]==0x6F) && (uuid16[1]==0xFD)) {
        // flash(&led2);
        char addr_string[BT_ADDR_LE_STR_LEN];
        bt_addr_le_to_str(addr, addr_string, sizeof(addr_string));
        if (write_flash) {
            sprintf(line, "%12u, %3d, %s, %s\n", timestamp, rssi, addr_string, buffer);
            printk("line len: %d\n", strlen(line));
        }
        if (show_raw && cdc_open) {
            printk("%12u, %3d, %s, %s\n", timestamp, rssi, addr_string, buffer);
        }
    }
}
*/

static bool data_cb_local(struct bt_data *data, void *user_data)
{
    u8_t *uuid16 = user_data;

    switch (data->type) {
    case BT_DATA_UUID16_ALL:
        memcpy(uuid16, data->data, 2);
        return false;
    default:
        return true;
    }
}

static void scan_cb_orig(const bt_addr_le_t *addr, s8_t rssi, u8_t adv_type,
            struct net_buf_simple *buf)
{
    // flash(&led2);
    u8_t uuid16[2] = {0, 0};
    u32_t timestamp = k_uptime_get_32();
    char rpi_string[64];
    int size = 0;
    for(u8_t i=0; i<buf->len; i++) {
        size += sprintf(rpi_string+size, "%02X", buf->data[i]);
    }

    bt_data_parse(buf, data_cb_local, uuid16);
    if ((uuid16[0]==0x6F) && (uuid16[1]==0xFD)) {
        flash(&led2);
        char addr_string[20];
        size = 0;
        for(u8_t i=0; i<5; i++) {
            size += sprintf(addr_string+size, "%02X:", addr->a.val[5-i]);
        }
        size += sprintf(addr_string+size, "%02X", addr->a.val[0]);
        char line[128];
        int line_len = sprintf(line, "%12d, %3d, %s, %s\n",
                        timestamp, rssi, addr_string, rpi_string);
        if (show_raw) {  // This puts it on the debugger
            printk("%s", line);
        }
        if (cdc_open&&show_raw) {  // This puts it on the debugger
            unsigned int key = irq_lock();
            int out_len = ring_buf_put(&outringbuf, line, line_len);
            irq_unlock(key);
            // printk("out_len: %d\n", out_len);
            uart_irq_tx_enable(cdc_dev);
        }
    }
}


void start_scan(void) {
    //  Start Scan
    int err = bt_le_scan_start(&scan_param, scan_cb_orig);
    if (err) {
        printk("Starting scanning failed (err %d)\n", err);
        return;
    } else {
        printk("Scan started\n");
    }

}

void stop_scan(void) {
    int err = bt_le_scan_stop();
    if (err) {
        printk("Stop scanning failed (err %d)\n", err);
        return;
    } else {
        printk("Scan stopped\n");
    }
}
```

## src/button.c
```c
#include "led.h"
#include <stdio.h>
#include <string.h>
#include <sys/ring_buffer.h>
#include <drivers/uart.h>

extern struct device *cdc_dev;
extern struct ring_buf outringbuf;

extern struct device *button_dev;

void button_pressed(struct device *dev, struct gpio_callback *cb,
            u32_t pins)
{
    char buffer[40];
    sprintf(buffer, "Button\n");
    ring_buf_put(&outringbuf, buffer, strlen(buffer));
    uart_irq_tx_enable(cdc_dev);
}

void button_init(void){
    int ret;
    static struct gpio_callback button_cb_data;

    button_dev = device_get_binding(DT_ALIAS_SW0_GPIOS_CONTROLLER);
    if (button_dev == NULL) {
        return;
    }

    ret = gpio_pin_configure(button_dev, DT_ALIAS_SW0_GPIOS_PIN,
                 DT_ALIAS_SW0_GPIOS_FLAGS | GPIO_INPUT);
    if (ret != 0) {
        return;
    }

    ret = gpio_pin_interrupt_configure(button_dev, DT_ALIAS_SW0_GPIOS_PIN,
                       GPIO_INT_EDGE_TO_ACTIVE);
    if (ret != 0) {
        return;
    }

    gpio_init_callback(&button_cb_data, button_pressed,
               BIT(DT_ALIAS_SW0_GPIOS_PIN));
    gpio_add_callback(button_dev, &button_cb_data);

}
```

## src/led.c
```c
#include "led.h"

void led_init(struct led *led) {
    int ret;
    led->dev = device_get_binding(led->gpio_dev_name);
    __ASSERT(led->dev != NULL, "Error: didn't find %s device\n",
            led->gpio_dev_name);

    ret = gpio_pin_configure(led->dev, led->gpio_pin, led->gpio_flags);
    if (ret != 0) {
        printk("Error %d: failed to configure pin %d '%s'\n",
            ret, led->gpio_pin, led->gpio_pin_name);
    }
    gpio_pin_set(led->dev, led->gpio_pin, 0);
}

void blink(struct led *led, uint8_t blink) 
{
    while(blink--) {
        gpio_pin_set(led->dev, led->gpio_pin, 1);
        k_msleep(200);
        gpio_pin_set(led->dev, led->gpio_pin, 0);
        k_msleep(200);
    }
}

void flash(struct led *led)
{
    gpio_pin_set(led->dev, led->gpio_pin, 1);
    k_msleep(20);
    gpio_pin_set(led->dev, led->gpio_pin, 0);
}
```

## src/led.h
```c
#ifndef _led_h
#define _led_h
#include <zephyr.h>
#include <device.h>
#include <devicetree.h>
#include <drivers/gpio.h>

struct led {
    const char *gpio_dev_name;
    const char *gpio_pin_name;
    unsigned int gpio_pin;
    unsigned int gpio_flags;
    struct device *dev;
};

#endif
extern struct led led1;
extern struct led led2;
// extern struct led led3;
// extern struct led led4;
extern void led_init(struct led *led);
extern void blink(struct led *led, uint8_t blink);
extern void flash(struct led *led);
```

## src/led_global.h
```c
struct led led1 = {
    .gpio_dev_name = DT_ALIAS_LED0_GPIOS_CONTROLLER,
    .gpio_pin_name = DT_ALIAS_LED0_LABEL,
    .gpio_pin = DT_ALIAS_LED0_GPIOS_PIN,
    .gpio_flags = GPIO_OUTPUT | DT_ALIAS_LED0_GPIOS_FLAGS,
    .dev = NULL
};

struct led led2 = {
    .gpio_dev_name = DT_ALIAS_LED1_GPIOS_CONTROLLER,
    .gpio_pin_name = DT_ALIAS_LED1_LABEL,
    .gpio_pin = DT_ALIAS_LED1_GPIOS_PIN,
    .gpio_flags = GPIO_OUTPUT | DT_ALIAS_LED1_GPIOS_FLAGS,
    .dev = NULL
};

struct led led3 = {
    .gpio_dev_name = DT_ALIAS_LED2_GPIOS_CONTROLLER,
    .gpio_pin_name = DT_ALIAS_LED2_LABEL,
    .gpio_pin = DT_ALIAS_LED2_GPIOS_PIN,
    .gpio_flags = GPIO_OUTPUT | DT_ALIAS_LED2_GPIOS_FLAGS,
    .dev = NULL
};

struct led led4 = {
    .gpio_dev_name = DT_ALIAS_LED3_GPIOS_CONTROLLER,
    .gpio_pin_name = DT_ALIAS_LED3_LABEL,
    .gpio_pin = DT_ALIAS_LED3_GPIOS_PIN,
    .gpio_flags = GPIO_OUTPUT | DT_ALIAS_LED3_GPIOS_FLAGS,
    .dev = NULL
};
```
