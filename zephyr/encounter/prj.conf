## CMakeLists.txt
```
# SPDX-License-Identifier: Apache-2.0

cmake_minimum_required(VERSION 3.13.1)
find_package(Zephyr HINTS $ENV{ZEPHYR_BASE})
project(encounter)

set_property(SOURCE <myfile>.S PROPERTY LANGUAGE C)
set_property(SOURCE <myfile>.s PROPERTY LANGUAGE C)
FILE(GLOB app_sources src/*.c src/*.s)
target_sources(app PRIVATE ${app_sources})

# zephyr_library_include_directories(${ZEPHYR_BASE}/samples/bluetooth)
```

## Kconfig
```
# Copyright (c) 2019 Peter Bigot Consulting, LLC
# SPDX-License-Identifier: Apache-2.0

mainmenu "littlefs sample"

config SEGGER_SYSTEMVIEW
    select RTT_CONSOLE

config APP_WIPE_STORAGE
	bool "Option to clear the flash area before mounting"
	help
	  Use this to force an existing file system to be created.

source "Kconfig.zephyr"
```

## prj.conf
```kconfig
CONFIG_STDOUT_CONSOLE=y
CONFIG_GPIO=y
CONFIG_USB=y
CONFIG_USB_DEVICE_STACK=y
CONFIG_USB_DEVICE_PRODUCT="CO19 BT Dongle v0.1"
CONFIG_USB_DEVICE_PID=0xC019
CONFIG_USB_DEVICE_VID=0xC019
CONFIG_LOG=y
CONFIG_USB_DRIVER_LOG_LEVEL_ERR=y
CONFIG_USB_CDC_ACM=y
CONFIG_USB_DEVICE_LOG_LEVEL_ERR=y
CONFIG_SERIAL=y

CONFIG_UART_INTERRUPT_DRIVEN=y
CONFIG_UART_LINE_CTRL=y
CONFIG_USB_UART_DTR_WAIT=n

CONFIG_ENTROPY_NRF5_RNG=y
# 
CONFIG_BT=y
# Not sure why debug log is needed for BT
# CONFIG_BT_DEBUG_LOG=y
# CONFIG_BT_SMP=y
#CONFIG_BT_PERIPHERAL=y
CONFIG_BT_BROADCASTER=y
CONFIG_BT_OBSERVER=y

# 
CONFIG_PRINTK=y
CONFIG_HEAP_MEM_POOL_SIZE=256
# CONFIG_ASSERT=y

CONFIG_REBOOT=y

# fs_dirent structures are big.
CONFIG_MAIN_STACK_SIZE=2048
# littlefs
CONFIG_SPI=y
CONFIG_FLASH=y
CONFIG_FLASH_MAP=y
CONFIG_FLASH_PAGE_LAYOUT=y
# CONFIG_APP_WIPE_STORAGE=y

CONFIG_FILE_SYSTEM=y
CONFIG_FILE_SYSTEM_LITTLEFS=y

CONFIG_UART_CONSOLE_INIT_PRIORITY=91
CONFIG_USE_SEGGER_RTT=y
CONFIG_RTT_CONSOLE=y
CONFIG_SEGGER_SYSTEMVIEW=y

CONFIG_COMPILER_OPT="-DSAEWOO_HACK -DENCOUNTER"
```

## boards/nrf52840dk_nrf52840.overlay
```dts
/*
 * Copyright (c) 2019 Peter Bigot Consulting, LLC
 *
 * SPDX-License-Identifier: Apache-2.0
 */

/delete-node/ &storage_partition;

&mx25r64 {
	partitions {
		compatible = "fixed-partitions";
		#address-cells = <1>;
		#size-cells = <1>;

		partition@0 {
			label = "storage";
			reg = <0x00100000 0x00100000>;
		};
	};
};
```

## boards/nrf52840dongle_nrf52840.overlay
```dts
/*
 * Copyright (c) 2019 Peter Bigot Consulting, LLC
 *
 * SPDX-License-Identifier: Apache-2.0
 */

/delete-node/ &storage_partition;

&mx25r64 {
	partitions {
		compatible = "fixed-partitions";
		#address-cells = <1>;
		#size-cells = <1>;

		partition@0 {
			label = "storage";
			reg = <0x00000000 0x00800000>;
		};
	};
};
```

## src/main.c
```c
/* main.c - Application main entry point */

/*
 * Copyright (c) 2015-2016 Intel Corporation
 *
 * SPDX-License-Identifier: Apache-2.0
 */

#include <zephyr/types.h>
#include <stddef.h>
#include <sys/printk.h>
#include <sys/util.h>

#include <bluetooth/bluetooth.h>
#include <bluetooth/hci.h>

#include "led.h"
#include "led_global.h"
#include "stdio.h"

#include <sys/ring_buffer.h>
#include <usb/usb_device.h>
#include <drivers/uart.h>

#include <time.h>
// includes for files
#include <fs/fs.h>
#include <fs/littlefs.h>
#include <storage/flash_map.h>
#ifdef ENCOUNTER
#include "encounter.h"
#endif
bool bt_started=false;
bool start_adv=false;
bool cdc_open=false;
bool write_flash=false;
bool flash_full=false;
bool show_raw=false;
bool show_binary=true;
bool show_kernel=false;
bool usb_error=false;

extern void button_init(void);
extern void bt_init(void);
extern void start_scan(void);
extern void stop_scan(void);
extern void bt_adv(void);
#define STACKSIZE 1024

struct bt_le_scan_param scan_param = {
    .type       = BT_HCI_LE_SCAN_PASSIVE,
    .options    = BT_LE_SCAN_OPT_NONE,
    .interval   = 0x0200,
    .window     = 0x0200,
};

#define RING_BUF_SIZE 1024
u8_t in_ring_buffer[RING_BUF_SIZE];
u8_t out_ring_buffer[RING_BUF_SIZE];
u8_t flash_ring_buffer[8192];

struct device *cdc_dev;
struct ring_buf inringbuf;
struct ring_buf outringbuf;
struct ring_buf flashringbuf;

struct device *button_dev;

#define MAX_PATH_LEN 255

#define LINE_LENGTH 100
FS_LITTLEFS_DECLARE_DEFAULT_CONFIG(storage);
static struct fs_mount_t lfs_storage_mnt = {
.type = FS_LITTLEFS,
.fs_data = &storage,
.storage_dev = (void *)DT_FLASH_AREA_STORAGE_ID,
.mnt_point = "/lfs",
};

struct fs_mount_t *mp = &lfs_storage_mnt;
struct fs_file_t encounter_file;
extern int flash_init(void);
extern void flash_close(void);
extern void ls(void);
extern void encounter_info(void);

uint32_t minute_timestamp=0;

uint8_t private_key[32];
uint8_t public_key[32];
uint8_t shared_key[32];
uint32_t next_minute;
uint32_t epochtimesync;
uint32_t offsettime=0;
uint8_t saewoo_hack[2];
#ifdef ENCOUNTER
Encounter_record encounters[IDX_MASK+1];
#endif
uint32_t c_fifo_last_idx=0;
uint32_t p_fifo_start_idx=0;
uint32_t p_fifo_last_idx=0;

bool hide_mac = true;

void cdc_init(void)
{
    printk("cdc_init\n");
    cdc_dev = device_get_binding("CDC_ACM_0");
    if (!cdc_dev) {
        printk("CDC ACM device not found\n");
        return;
    }
}
void usb_init(void) {
    // ret = usb_enable(usb_status_cb);
    int ret = usb_enable(NULL);
    printk("usb_init\n");
    if (ret != 0) {
        printk("Failed to enable USB\n");
        return;
    }
}

u8_t flash_buffer[4096];
int total_written=0;
int total_cache=0;
// #define CHUNK 4000

K_THREAD_DEFINE(bt_adv_id, STACKSIZE, bt_adv, NULL, NULL, NULL,
            3, 0, 0);

static void cdc_interrupt_handler(struct device *dev)
{
    while (uart_irq_update(dev) && uart_irq_is_pending(dev)&&(usb_error==0)) {
        if (uart_irq_rx_ready(dev)) {
            int recv_len, rb_len;
            u8_t buffer[64];
            size_t len = MIN(ring_buf_space_get(&inringbuf),
                     sizeof(buffer));

            recv_len = uart_fifo_read(dev, buffer, len);

            rb_len = ring_buf_put(&inringbuf, buffer, recv_len);
            if (rb_len < recv_len) {
                printk("Drop %u bytes\n", recv_len - rb_len);
            }

            // LOG_DBG("tty fifo -> inringbuf %d bytes", rb_len);
        }

        if (uart_irq_tx_ready(dev)) {
            u8_t buffer[64];
            int rb_len, send_len;

            unsigned int key = irq_lock();
            rb_len = ring_buf_get(&outringbuf, buffer, sizeof(buffer));
            irq_unlock(key);
            if (!rb_len) {
                // LOG_DBG("Ring buffer empty, disable TX IRQ");
                uart_irq_tx_disable(dev);
                continue;
            }

            send_len = uart_fifo_fill(dev, buffer, rb_len);
            if (send_len < rb_len) {
                printk("Drop %d bytes\n", rb_len - send_len);
            }

            // LOG_DBG("outringbuf -> tty fifo %d bytes", send_len);
        }
    }
}
void dtr_init(void) {
    u32_t baudrate, dtr = 0U;
    int ret;

    printk("Wait for DTR");
    while (true) {
        uart_line_ctrl_get(cdc_dev, UART_LINE_CTRL_DTR, &dtr);
        if (dtr) {
            break;
        } else {
            /* Give CPU resources to low priority threads. */
            k_sleep(K_MSEC(100));
        }
    }
    printk("DTR set");

    /* They are optional, we use them to test the interrupt endpoint */
    ret = uart_line_ctrl_set(cdc_dev, UART_LINE_CTRL_DCD, 1);
    if (ret) {
        printk("Failed to set DCD, ret code %d", ret);
    }

    ret = uart_line_ctrl_set(cdc_dev, UART_LINE_CTRL_DSR, 1);
    if (ret) {
        printk("Failed to set DSR, ret code %d", ret);
    }

    /* Wait 1 sec for the host to do all settings */
    k_busy_wait(1000000);

    ret = uart_line_ctrl_get(cdc_dev, UART_LINE_CTRL_BAUD_RATE, &baudrate);
    if (ret) {
        printk("Failed to get baudrate, ret code %d", ret);
    } else {
        printk("Baudrate detected: %d\n", baudrate);
    }

    uart_irq_callback_set(cdc_dev, cdc_interrupt_handler);

    /* Enable rx interrupts */
    uart_irq_rx_enable(cdc_dev);
}

void clear_encounter(void) {
    int rc;
    char fname[MAX_PATH_LEN];
    bool pause = write_flash;

    write_flash = false;
    //  Wait to finish any writes...

    //
    snprintf(fname, sizeof(fname), "%s/encounters", mp->mnt_point);
    rc = fs_close(&encounter_file);
    printk("close rc: %d\n", rc);
    // delete file with "unlink"
    rc = fs_unlink(fname);
    printk("unlink rc: %d\n", rc);

    rc = fs_open(&encounter_file, fname);
    if (rc < 0) {
        printk("FAIL: open %s: %d\n", fname, rc);
        return;
    }
    write_flash = pause;
    flash_full = false;
}

void uart_print(char *buffer, int len){
    unsigned int key = irq_lock();
    ring_buf_put(&outringbuf, buffer, len);
    irq_unlock(key);
    uart_irq_tx_enable(cdc_dev);
}

void uart_printf(char *format, ...) {

    va_list arg;
    va_start(arg, format);
    int len;
    static char buffer[64];

    len = vsnprintf(buffer, 64,format, arg);

    unsigned int key = irq_lock();
    ring_buf_put(&outringbuf, buffer, len);
    irq_unlock(key);
    uart_irq_tx_enable(cdc_dev);
}

void write_time (uint32_t local, uint32_t rawtime) {
    int rc;
    char fname[MAX_PATH_LEN];
    struct fs_file_t time_file;

    snprintf(fname, sizeof(fname), "%s/timeinfo", mp->mnt_point);

    rc = fs_open(&time_file, fname);
    if (rc < 0) {
        uart_printf("FAIL: open %s: %d\n", fname, rc);
        return;
    }

    //     rc = fs_read(&file, &boot_count, sizeof(boot_count));
    //     printk("%s read count %u: %d\n", fname, boot_count, rc);

    rc = fs_write(&time_file, &local, sizeof(local));
    rc = fs_write(&time_file, &rawtime, sizeof(rawtime));
    rc = fs_close(&time_file);
}

void read_time(uint32_t *local, uint32_t *rawtime) {
    int rc;
    char fname[MAX_PATH_LEN];
    struct fs_file_t time_file;

    snprintf(fname, sizeof(fname), "%s/timeinfo", mp->mnt_point);

    rc = fs_open(&time_file, fname);
    if (rc < 0) {
        uart_printf("FAIL: open %s: %d\n", fname, rc);
        return;
    }

    rc = fs_read(&time_file, local, 4);
    rc = fs_read(&time_file, rawtime, 4);
    rc = fs_close(&time_file);

}

void got_g(void) {
    struct fs_file_t file;
    char line[128];
    char fname[MAX_PATH_LEN];
    int rc;
    int total_bytes = 0;
    int pos = 0;
    int record_length = 0;
    int out_len = 0;
    memset(line, 0, 128);

    if (show_binary) {
        record_length = 32;
    } else {
        record_length = 100;
    }

    snprintf(fname, sizeof(fname), "%s/encounters", mp->mnt_point);

    rc = fs_open(&file, fname);
    if (rc < 0) {
        printk("FAIL: open %s: %d\n", fname, rc);
        return;
    }
    printk("Opened file rc: %d\n", rc);
    int line_count = 0;
    while((rc = fs_read(&file, line, record_length))) {
        line[rc] = 0;
        if (rc == record_length) {
            unsigned int key = irq_lock();
            out_len = ring_buf_put(&outringbuf, line, rc);
            irq_unlock(key);
            uart_irq_tx_enable(cdc_dev);
            if (out_len < rc) {
                uart_printf("problem got_g, out_len: %d, line_len: %d\n", out_len, rc);
            }

            total_bytes += out_len;
            line_count++;
        }
    }
    pos = fs_tell(&file);
    rc = fs_close(&file);
    // printk("Close file rc: %d\n", rc);
    uart_printf("total_bytes: %d\n", total_bytes);
    // uart_print(line, rc);
}

void cleanup_cache(void) {
    int total_len;
    // unsigned int key;
    char buffer[64];
    int len;
    int record_length, number_of_events;
    if (show_binary) {
        record_length = 32;
    } else {
        record_length = 100;
    }

    total_len = ring_buf_get(&flashringbuf, flash_buffer, 4096);

    // len = sprintf(buffer, "total_written:  %d, total_cache: %d left: %d\n",
    //         total_written, total_cache, total_len);
    // uart_print(buffer, len);

    ring_buf_reset(&flashringbuf);

    number_of_events = total_len / record_length;
    total_len = number_of_events * record_length; 

    // len = sprintf(buffer, "len to write to file: %d\n", total_len);
    // uart_print(buffer, len);

    int len_written = fs_write(&encounter_file, flash_buffer, total_len);
    fs_sync(&encounter_file);
    total_written += len_written;

    len = sprintf(buffer, "cleanup cache total_written:  %d, total_cache: %d\n",
            total_written, total_cache);
    uart_print(buffer, len);
}
void flash_store(void) {
    Encounter_record *current_encounter;
    // uint32_t start = p_fifo_last_idx;
    uint32_t timestamp = k_uptime_get_32();
    uint32_t epoch_minute = ((timestamp-offsettime) / 1000 + epochtimesync)/60;
    /*
    uart_printf("epoch_minute: %d, p_idx: %d, c_idx: %d\n", epoch_minute,
                    p_fifo_last_idx, c_fifo_last_idx);
    */
    while (c_fifo_last_idx > p_fifo_last_idx) {

        current_encounter = encounters + (p_fifo_last_idx & IDX_MASK);
        // uart_printf("idx: %d, minute: %d\n", p_fifo_last_idx, current_encounter->minute);
        if (current_encounter->minute < epoch_minute) { // this is an old record write to flash
            uint32_t shared_key[32];
            // X25519_calc_shared_secret(shared_key, private_key, current_encounter->public_key);
            int len_written = fs_write(&encounter_file, (uint8_t *)current_encounter, 64);
            fs_sync(&encounter_file);
            total_written += len_written;

            p_fifo_last_idx++;
        } else {
            // uart_printf("Done flash_store looking back\n");
            return;
        }
    }
    // uart_printf("Done flash_store, after while\n");

}
void flash_store_old(void) {
    int space;
    int total_len = 0;
    int len_written;
    int CHUNK = 0;

    if (show_binary) {
        CHUNK = 2048;
    } else {
        CHUNK = 4000;
    }

    space = ring_buf_space_get(&flashringbuf);
    if (!write_flash) {
        if (space<8191) {
            cleanup_cache();
        }
    } else {
        ;
        /* char buffer[64]; */
        /* int len = sprintf(buffer, "flash_store: total_written:  %d, total_cache: %d\n", */
        /*         total_written, total_cache); */
        /* uart_print(buffer, len); */
        /*
        printk("Space: %d, total_written: %d, total_cache: %d\n", 
                space, total_written, total_cache);
                */
    } 
    if (space < (8191-CHUNK)) {
        flash(&led4);
        /*
        do {
            total_len += ring_buf_get(&flashringbuf, flash_buffer, CHUNK);
        } while (total_len<CHUNK);
        */
        total_len += ring_buf_get(&flashringbuf, flash_buffer, CHUNK);
        len_written = fs_write(&encounter_file, flash_buffer, CHUNK);
        fs_sync(&encounter_file);
        total_written += len_written;
        printk("Space: %d, total_written: %d, total_cache: %d\n", 
                space, total_written, total_cache);
        if (len_written < CHUNK) {
            printk("Disk full???\n");
        }
    }
}

void parse_command(char c) {
    // int total_len, len_written;
            switch (c) {
                case 'y':  // start_scan
                    {
                    start_scan();
                    break;
                    }
                case 'x':  // stop_scan
                    {
                    stop_scan();
                    break;
                    }
                case 'v': // change scan params
                    {
                    uint16_t interval, window;
                    int len = 0;
                    do {
                        len += ring_buf_get(&inringbuf, (uint8_t *)&(interval)+len, 1);
                    } while (len < 2);
                    len =0;
                    do {
                        len += ring_buf_get(&inringbuf, (uint8_t *)&(window)+len, 1);
                    } while (len < 2);

                    // uart_printf("interval %u, window: %u\n", interval, window);
                    scan_param.interval = interval;
                    scan_param.window = window;
                    break;
                    }
                case 'e':  // resume adv thread
                    {
                    //  thread_resume/suspend doesn't seem to work
                    //k_thread_resume(bt_adv_id);
                    start_adv = true;
                    break;
                    }
                case 'd':  // suspend adv thread
                    {
                    //  thread_resume/suspend doesn't seem to work
                    //k_thread_suspend(bt_adv_id);
                    start_adv = false;
                    break;
                    }
                case 'i': 
                    {
                    uart_printf("start_adv:%d, raw:%d, binary:%d, write_flash:%d, hide:%d\n", 
                            start_adv, show_raw, show_binary, write_flash, hide_mac);
                    break;
                    }
                case 'g':  // Get all data from FLASH
                    {
                    printk("got g\n");
                    got_g();
                    break;
                    }
                case 'c':  // Clear flash memory
                    {
                    printk("got c\n");
                    clear_encounter();
                    // clear variable keeping track of what is written
                    total_written = 0;
                    total_cache = 0;
                    printk("done clear\n");
                    break;
                    }
                case 'k':  // Show data on printk/debugger
                    printk("got k\n");
                    show_kernel = !show_kernel ;
                    break;
                case 'r':  // Show data on USB_SERIAL PORT
                    printk("got r\n");
                    show_raw = true ;
                    break;
                case 'z':  // Stop data on USB_SERIAL PORT
                    printk("got z\n");
                    show_raw = false ;
                    break;
                case 'l':  // list files to debugger
                    {
                    printk("got l\n");
                    ls();
                    break;
                    }
                case 'w':  // Write data to flash
                    printk("got w\n");
                    write_flash = true ;
                    break;
                case 's':  // Stop write data to flash
                    {
                    printk("got s\n");
                    write_flash = false;
                    // No cleanup for encounter tracing
                    // cleanup_cache();


                    break;
                    }
                case 'f': // get info about flash and cache
                    {
                    char buffer[64];
                    int len = sprintf(buffer, "total_written:  %d, total_cache: %d\n",
                            total_written, total_cache);
                    uart_print(buffer, len);
                    break;
                    }
                case 'b':  // output data as binary
                    printk("got b\n");
                    show_binary = true ;
                    break;
                case 'n':  // output data as text
                    printk("got n\n");
                    show_binary = false ;
                    break;
                case 'u':  // get timestamp
                    {
                    uint32_t local, human;
                    read_time(&local, &human); 
                    uart_printf("%u, %u\n", local, human);
                    // printk("got u\n");
                    break;
                    }
                case 't':  // get timestamp
                    {
                    printk("got t\n");
                    int len = 0;
                    // char buffer[64];
                    uint32_t timestamp = k_uptime_get_32();
                    uint8_t *temp = (uint8_t *) &epochtimesync;
                    //  Have to get 1 byte at a time...
                    do {
                        len += ring_buf_get(&inringbuf, temp+len, 1);
                    } while (len < 4);

                    // len=sprintf(buffer, "%u, %u\n", epochtimesync, timestamp);
                    // uart_print(buffer, len);
                    write_time(timestamp, epochtimesync);
                    offsettime = timestamp;
                    struct tm ts;
                    time_t rawtime = (const time_t) epochtimesync;
                    ts = *gmtime(&rawtime);
                    int delta = 60 - ts.tm_sec;
                    if (delta <= 0) {
                        delta += 60;
                    }
                    next_minute = timestamp + delta * 1000;
                    /*
                    len = sprintf(buffer, "Day: %d Month: %d Year: %d\n",
                                    ts.tm_mday, ts.tm_mon, ts.tm_year);
                    uart_print(buffer, len);
                    uint32_t a, b;
                    read_time(&a, &b); 
                    uart_printf("%u, %u\n", a, b);
                    */
                    break;
                    }
                case 'j':
                    uart_printf("scan interval %u, window: %u\n", 
                            scan_param.interval, scan_param.window);
                    #ifdef ENCOUNTER
                    uart_printf("sizeof encounter struct: %d\n", sizeof(Encounter_record));
                    #endif
                    break;
                case 'a':
                    printk("got a\r");
                    uint32_t timestamp = k_uptime_get_32();
                    printk("timestamp: %d\r", timestamp);
                    unsigned int key = irq_lock();
                    ring_buf_put(&outringbuf,(uint8_t *) &timestamp, 4);
                    irq_unlock(key);
                    uart_irq_tx_enable(cdc_dev);
                    break;
                case 'o':
                    break;
                case 'p':
                    hide_mac = false;
                    break;
                case 'q':
                    hide_mac = true;
                    break;
                default:
                    {
                    printk("got %c, not defined\n", c);
                    break;
                    }
            }
}

void main(void)
{
    // int err;
    led_init(&led1);
    led_init(&led2);
    led_init(&led3);
    led_init(&led4);
    for (int i=0; i<5; i++){
        flash(&led1);
        flash(&led2);
        flash(&led3);
        flash(&led4);
    }
    button_init();
    // printk("Starting Scanner/Advertiser Demo\n");
    ring_buf_init(&inringbuf, sizeof(in_ring_buffer), in_ring_buffer);
    ring_buf_init(&outringbuf, sizeof(out_ring_buffer), out_ring_buffer);
    ring_buf_init(&flashringbuf, sizeof(flash_ring_buffer), flash_ring_buffer);
    flash_init();
    for (int i=0; i<5; i++){
        flash(&led1);
    }
    // printk("Bluetooth initialized\n");
    bt_init();
    // start_adv = true;
    // There is a thread that runs the bt_adv
    // bt_adv();
    //
    start_scan();
    cdc_init();
    usb_init();
    dtr_init();
    cdc_open=true;
    u8_t c;
    while (true) {
        while(ring_buf_get(&inringbuf, &c, 1)){
            parse_command(c);
        }
        if (write_flash) flash_store();
        k_sleep(K_MSEC(2000));

    }
}
```

## src/adv.c
```c
#include <zephyr/types.h>
#include <stddef.h>
#include <sys/printk.h>
#include <sys/util.h>

#include <bluetooth/bluetooth.h>
#include <bluetooth/hci.h>
#include <stdio.h>

#define RPI_PERIOD 10000  // mSec
#include "led.h"
#include <drivers/uart.h>
#include <sys/ring_buffer.h>

#include <fs/fs.h>

#include "x25519-cortex-m4.h"
extern bool bt_started;
extern bool start_adv;
extern bool cdc_open;
extern bool write_flash;
extern bool flash_full;
extern bool show_binary;
extern bool show_raw;
extern bool show_kernel;
extern struct bt_le_scan_param scan_param ;
extern struct device *cdc_dev;
extern struct ring_buf outringbuf;
extern struct ring_buf flashringbuf;
extern struct fs_file_t encounter_file;
extern int total_cache;
extern uint8_t private_key[32];
extern uint8_t public_key[32];
extern uint8_t shared_key[32];
extern uint32_t next_minute;
extern uint8_t saewoo_hack[2];

#define BT_LE_ADV_NCONN2 BT_LE_ADV_PARAM(4, BT_GAP_ADV_FAST_INT_MIN_2, \
                                        BT_GAP_ADV_FAST_INT_MAX_2, NULL)
extern bool hide_mac;
void bt_init(void) {
    int err;
    printk("Starting Scanner/Advertiser Demo\n");

    /* Initialize the Bluetooth Subsystem */
    err = bt_enable(NULL);
    if (err) {
        printk("Bluetooth init failed (err %d)\n", err);
        // blink(&led2, 1);
        return;
    }
    bt_started = true;
    printk("Bluetooth initialized\n");
}

bool update_public_key(void) {
        // Check if we need to change key
        //
        //  Need to handle rollover... at some point
        u32_t timestamp = k_uptime_get_32();
        if (timestamp >= next_minute) {
            while (k_uptime_get_32() >= next_minute) {
                next_minute += 60000;
            }
            // update secret key
            sys_csrand_get(private_key, 32);
            X25519_calc_public_key(public_key, private_key);
            if (start_adv) {  // blink once a minute if advertising
                blink(&led1,1);
                if (write_flash) {
                    blink(&led3,1);
                }
            }
            return true;
        }
        return false;
}

void bt_adv (void) {
    /* 
     *
     *
     *
     * NEED TO FIX 1 SECOND PROBLEM with updating keys and current_minute
     *
     *
     *
     */

    u8_t *tcn;
    struct bt_data encounter_ad[] = {
            BT_DATA_BYTES(BT_DATA_FLAGS, BT_LE_AD_NO_BREDR),
            // BT_DATA_BYTES(BT_DATA_TX_POWER, 0),
            BT_DATA_BYTES(BT_DATA_UUID16_ALL, 0x6F, 0xFD),
            BT_DATA_BYTES(BT_DATA_SVC_DATA16,
                            0x6F, 0xFD,
                            0,0,0,0,0,0,0,0,
                            0,0,0,0,0,0,0,0,
                            0x04, 0x3, 0x2, 0x1)
    };
    bool adv_part_a = true;
    int err;

    tcn = encounter_ad[2].data+2; // 3rd item in array of messages is RPI
    tcn[3] = 0x4;  // set to 4 by google/apple protocol

    do {
        if (!start_adv) {
            bt_le_adv_stop();

            while (!start_adv) {
                k_sleep(K_MSEC(1000));
                update_public_key();
            }
            if(hide_mac) {
                err = bt_le_adv_start(BT_LE_ADV_NCONN, encounter_ad,
                                        ARRAY_SIZE(encounter_ad), NULL, 0);
            } else {
                err = bt_le_adv_start(BT_LE_ADV_NCONN2, encounter_ad,
                                    ARRAY_SIZE(encounter_ad), NULL, 0);
            }
            if (err) {
                printk("Advertising failed to start (err %d)\n", err);
                return;
            }
        }
        bool bool_new_key = update_public_key();
        // update tcn
        if (adv_part_a) {
            // advertise the first 16 bytes of public_key
            tcn[0] = 0;
            memcpy(tcn+4, public_key, 16);
            adv_part_a = false;
        } else {
            // advertise the second 16 bytes of public_key
            tcn[0] = 1;
            memcpy(tcn+4, public_key+16, 16);
            adv_part_a = true;
        }
        if (bool_new_key && hide_mac) {
            bt_le_adv_stop();
            err = bt_le_adv_start(BT_LE_ADV_NCONN, encounter_ad,
                                  ARRAY_SIZE(encounter_ad), NULL, 0);
        } else {
            err = bt_le_adv_update_data(encounter_ad, ARRAY_SIZE(encounter_ad), NULL, 0);
        }
        k_sleep(K_MSEC(1000));

        // printk("Update rpi\n");
    } while (1);
}
```

## src/button.c
```c
../../bt_cdc_fs/src/button.c
```

## src/encounter.h
```c
#pragma once
#ifndef ENCOUNTER_H
#define ENCOUNTER_H

#define IDX_MASK        15

struct Ch_data {
    uint8_t mean;
    uint8_t n;
    uint8_t min;
    uint8_t max;
    uint16_t var;
};

struct RSSI_data {
   struct Ch_data ch37;
   struct Ch_data ch38;
   struct Ch_data ch39;
};

typedef struct Encounter_records {
   uint8_t  mac[6];
   uint8_t first_time;
   uint8_t last_time;
   uint32_t minute;
   uint8_t public_key[32];
   struct Ch_data rssi_data[3];
   uint8_t flag;
   uint8_t flag2;
} Encounter_record;



#endif // ENCOUNTER_H
```

## src/file.c
```c
../../bt_cdc_fs/src/file.c
```

## src/led.c
```c
../../bt_cdc_fs/src/led.c
```

## src/led.h
```c
../../bt_cdc_fs/src/led.h
```

## src/led_global.h
```c
../../bt_cdc_fs/src/led_global.h
```

## src/rpi.c
```c
../../bt_cdc_fs/src/rpi.c
```

## src/scan.c
```c
#include <zephyr/types.h>
#include <stddef.h>
#include <sys/printk.h>
#include <sys/util.h>

#include <bluetooth/bluetooth.h>
#include <bluetooth/hci.h>
#include <stdio.h>

#define RPI_PERIOD 10000  // mSec
#include "led.h"
#include <drivers/uart.h>
#include <sys/ring_buffer.h>

#include <fs/fs.h>
#include "encounter.h"
#include "x25519-cortex-m4.h"
#define SCAN_DEBUG
extern void rpi_init(u8_t *rpi);
extern void rpi_update(u8_t *rpi);
extern void uart_printf(char *format, ...);

extern bool bt_started;
extern bool start_adv;
extern bool cdc_open;
extern bool write_flash;
extern bool flash_full;
extern bool show_binary;
extern bool show_raw;
extern bool show_kernel;
extern struct bt_le_scan_param scan_param ;
extern struct device *cdc_dev;
extern struct ring_buf outringbuf;
extern struct ring_buf flashringbuf;
extern struct fs_file_t encounter_file;
extern int total_cache;
extern uint8_t private_key[32];
extern uint8_t public_key[32];
extern uint8_t shared_key[32];

extern uint8_t saewoo_hack[2];

extern Encounter_record encounters[IDX_MASK+1];

extern uint32_t epochtimesync;
extern uint32_t offsettime;
extern uint32_t next_minute;

extern uint32_t c_fifo_last_idx;

extern uint32_t p_fifo_last_idx;

static bool data_cb_local(struct bt_data *data, void *user_data)
{
    u8_t *uuid16 = user_data;

    switch (data->type) {
    case BT_DATA_UUID16_ALL:
        memcpy(uuid16, data->data, 2);
        return false;
    default:
        return true;
    }
}

void uart_ch_rssi(struct Ch_data e) {
    uart_printf("%d %d %d %d %d\n", e.n, e.max, e.min, e.mean, e.var);

}

int in_encounters_fifo(const uint8_t * mac, uint32_t epoch_minute) {
    /*
     *
     * Search backward during the "last minutes" worth of encounters
     *
     */
    Encounter_record *current_encounter;
    if (c_fifo_last_idx == 0) return -1;
    int start = c_fifo_last_idx - 1;
    do {
        current_encounter = encounters + (start & IDX_MASK);
        if (current_encounter->minute < epoch_minute) return -1;
        if (memcmp(current_encounter->mac, mac, 6) == 0) return start;
        start--;
    } while (start>=0);
    return -1;
}

static void scan_cb_orig(const bt_addr_le_t *addr, s8_t rssi, u8_t adv_type,
            struct net_buf_simple *buf)
{
    // flash(&led2);
    u8_t uuid16[2] = {0, 0};
    u32_t timestamp = k_uptime_get_32();
    // uint8_t raw_event[32];
    char rpi_string[64];
    /*
    bt_addr_le_t a[CONFIG_BT_ID_MAX];
    int count;
    */
#ifdef SCAN_DEBUG
    printk("%u\tIn scan callback\n", timestamp);
#endif
    /*
    bt_id_get(a, &count);
    uart_printf("num of id: %d\n", count);
    for (int i=0; i<count; i++) {
        bt_addr_le_to_str(a+i, rpi_string, BT_ADDR_STR_LEN);
        uart_printf("id %d: %s\n", i, rpi_string);
    }
    int size = 0;
    for(u8_t i=0; i<buf->len; i++) {
        size += sprintf(rpi_string+size, "%02X", buf->data[i]);
    }
    uart_printf("name: %s\n", bt_get_name());
    bt_addr_le_to_str(addr, rpi_string, BT_ADDR_STR_LEN);
    uart_printf("%s  ", rpi_string);
    */

    rssi = -rssi;

    bt_data_parse(buf, data_cb_local, uuid16);
#ifdef SCAN_DEBUG
    printk("\tfinish parse data\n");
#endif
    
    //if ((uuid16[0]==0x6F) && (uuid16[1]==0xFD)) {
    if (true) {
        flash(&led2);
        Encounter_record *current_encounter;
        /*  old stuff, raw event 32 bytes
         *
         *
        memcpy(raw_event,(uint8_t *) &timestamp, 4);
        memcpy(raw_event+4, addr->a.val, 6);
        // raw_event[10] = 0xFF;
        raw_event[10] = saewoo_hack[0]+37;
        raw_event[11] = rssi;
        memcpy(raw_event+12, buf->data+6, 20);  // skip 0x6FFD patterns
        */

        // uart_printf("ch: %d, rssi: %d ", 37+saewoo_hack[0], rssi);

        int sec_timestamp = (timestamp - (next_minute - 60000)) / 1000;
        uint32_t epoch_minute = ((timestamp-offsettime) / 1000 + epochtimesync)/60;

#ifdef SCAN_DEBUG
    printk("\tTry to check if in fifo\n");
#endif
        // Check if record already exists by mac
        int idx = in_encounters_fifo(addr->a.val, epoch_minute);
#ifdef SCAN_DEBUG
    printk("\tp_idx: %d, c_idx: %d\n", p_fifo_last_idx, c_fifo_last_idx);
#endif
        // uart_printf("idx:%d  ", idx);
        if (idx<0) {
            // No index returned
#ifdef SCAN_DEBUG
    printk("\tCreat new encounter\n");
#endif
            current_encounter = encounters + (c_fifo_last_idx & IDX_MASK);
            memcpy(current_encounter->mac, addr->a.val, 6);
            current_encounter->rssi_data[saewoo_hack[0]].n = 1;
            current_encounter->rssi_data[saewoo_hack[0]].max = rssi;
            current_encounter->rssi_data[saewoo_hack[0]].min = rssi;
            current_encounter->rssi_data[saewoo_hack[0]].mean = rssi;
            current_encounter->rssi_data[saewoo_hack[0]].var = 0;
            current_encounter->first_time = sec_timestamp;
            current_encounter->last_time = sec_timestamp;
            current_encounter->minute = epoch_minute;
            c_fifo_last_idx++;
        } else {
#ifdef SCAN_DEBUG
    printk("\tFound previous encounter: %d, %d\n",idx, (idx&IDX_MASK));
#endif
            current_encounter = encounters + (idx & IDX_MASK);
#ifdef SCAN_DEBUG
    printk("\tsaewoo_hack[0]:%d\n",saewoo_hack[0] );
#endif
            int n = ++current_encounter->rssi_data[saewoo_hack[0]].n;
            if (rssi > current_encounter->rssi_data[saewoo_hack[0]].max) {
                current_encounter->rssi_data[saewoo_hack[0]].max = rssi;
            }
            if (rssi < current_encounter->rssi_data[saewoo_hack[0]].max) {
                current_encounter->rssi_data[saewoo_hack[0]].min = rssi;
            }
#ifdef SCAN_DEBUG
    printk("\tcompute new mean: n:%d\n",n );
#endif
            if (n>0) {
                int mean = current_encounter->rssi_data[saewoo_hack[0]].mean;
                int new_mean = mean + (rssi - mean + n/2)/n;
                current_encounter->rssi_data[saewoo_hack[0]].mean = new_mean;
                current_encounter->rssi_data[saewoo_hack[0]].var += (rssi-new_mean)*(rssi-mean);
            }  // otherwise, 255 interactions in 1 minute... It has rolled over... don't computer new stuff
            current_encounter->last_time = sec_timestamp;
            current_encounter->minute = epoch_minute;
        }
        // uart_ch_rssi(current_encounter->rssi_data[saewoo_hack[0]]);
        // Update bobs shared key
#ifdef SCAN_DEBUG
    printk("\tDo crypto stuff\n");
#endif
        uint8_t hi_lo_byte = *(buf->data+6);
        // uart_printf("\ttime: %u, flag: %d, hi_lo_byte: %d\n", timestamp, current_encounter->flag, hi_lo_byte);
        if (( current_encounter->flag &0x3) < 3) {
            if (((current_encounter->flag & 0x1) == 0) && (hi_lo_byte==0)) {
                uart_printf("got lo part of public key\n");
                memcpy(current_encounter->public_key, buf->data+6+4, 16);
                current_encounter->flag |= 0x1;
            }
            if (((current_encounter->flag & 0x2) == 0) && (hi_lo_byte==1)) {
                uart_printf("got hi part of public key\n");
                memcpy(current_encounter->public_key+16, buf->data+6+4, 16);
                current_encounter->flag |= 0x2;
            }
        }
        if (((current_encounter->flag&0x4)==0) && ((current_encounter->flag&0x3) == 3)) {
            uart_printf("calc shared key\n");
            X25519_calc_shared_secret(shared_key, private_key, current_encounter->public_key);
            memcpy(current_encounter->public_key, shared_key, 32);
            current_encounter->flag |= 0x4;

        }
#ifdef SCAN_DEBUG
         printk("\tdone scan cb\n");
#endif
        // uart_encounter(*current_encounter);
    }
}


void start_scan(void) {
    //  Start Scan
    int err = bt_le_scan_start(&scan_param, scan_cb_orig);
    if (err) {
        printk("Starting scanning failed (err %d)\n", err);
        return;
    } else {
        printk("Scan started\n");
    }

}

void stop_scan(void) {
    int err = bt_le_scan_stop();
    if (err) {
        printk("Stop scanning failed (err %d)\n", err);
        return;
    } else {
        printk("Scan stopped\n");
    }
}
```
